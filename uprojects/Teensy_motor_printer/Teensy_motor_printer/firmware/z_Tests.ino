void test()
{
  blinkInit();
#ifdef TESTS
  cmpStrTests();
  // addrPrimUniquenessTest();
  // reverseStackTests();
  // fireSingleAddress( 0, 10 );
  // beginsWithTests();
  // transitionCountTests();
  // B64_to_B10Tests();
  // printBufferNozzleLookupTests();
  // nozzleTransitionTests();
  // oldAndNewTests();
  // bufferPositionInit();
  // bufferPositionTests();
#endif

#ifdef PRINT_TESTS
  printBufferInit();
#endif // PRINT_TESTS

}
void cyclicTest()
{
#ifdef BLINK_STANDARD
  updateBlink();
#endif // BLINK_STANDARD

#ifdef BLINK_ON_RX
  updateRxBlink();
#endif // BLINK_ON_RX

#ifdef TESTS
  // virtualVelocityTest();
#endif // TESTS


}

int
  _blinkToggleAtTime = 0,
  _blinkInterval = 500
  ;
bool _blinkState = false;
#ifdef BLINK_ON_RX
bool _blinkEnabled = false;
#endif // BLINK_ON_RX
void blinkInit()
{
  pinMode( LED_BUILTIN, OUTPUT );
}
#ifdef BLINK_STANDARD
void updateBlink()
{
  if( millis() >= _blinkToggleAtTime )
  {
    _blinkState = !_blinkState;
    _blinkToggleAtTime = millis() + _blinkInterval;
  }

  digitalWrite( LED_BUILTIN, _blinkState );
}
#endif // BLINK_STANDARD

#ifdef BLINK_ON_RX
void enableBlink(bool ledOn )
{
  _blinkEnabled = ledOn;
}
void updateRxBlink()
{
  if( millis() >= _blinkToggleAtTime )
  {
    _blinkState = !_blinkState;
    _blinkToggleAtTime = millis() + _blinkInterval;
  }
  digitalWrite( LED_BUILTIN, _blinkState & _blinkEnabled );
}
#endif // BLINK_ON_RX

#ifdef PRINT_TESTS

const int TEST_BUFFER_SIZE = 70;
char* _pp_testBuffer [ TEST_BUFFER_SIZE ]
{

  // Follow Thru 70 Lines
(char*)  "SBR O9 AAAAAAAAAAAAAAAAAAAAAAAAAAAAAAAAAAAAAAAAAAAAAAAAAA",
(char*)  "SBR oG AAAAAAB///////////////////////////////////+AAAAAAA",
(char*)  "SBR ra AAAAAAB//////4AAAAAAAH//////gAAAAAAAAAAAAAAAAAAAAA",
(char*)  "SBR yr AAAAAAB//////4AAAAAAAAAAAAAAAAAAAAAAAAAAAAAAAAAAAA",
(char*)  "SBR 2p AAAAAAAAAAAAAAAAAAAAAAAAAAAAAAAAAAAAAAAAAAAAAAAAAA",
(char*)  "SBR 59 AAAAAAAAAAAAAAAAAAAAAH////////////////////+AAAAAAA",
(char*)  "SBR 97 AAAAAAAAAAAAAAAAAAAAAH//////gAAAAAAAf/////+AAAAAAA",
(char*)  "SBR BBP AAAAAAAAAAAAAAAAAAAAAH////////////////////+AAAAAAA",
(char*)  "SBR BFN AAAAAAAAAAAAAAAAAAAAAAAAAAAAAAAAAAAAAAAAAAAAAAAAAA",
(char*)  "SBR BIg AAAAAAB///////////////////////////////////+AAAAAAA",
(char*)  "SBR BMe AAAAAAAAAAAAAAAAAAAAAAAAAAAAAAAAAAAAAAAAAAAAAAAAAA",
(char*)  "SBR BPy AAAAAAB///////////////////////////////////+AAAAAAA",
(char*)  "SBR BTw AAAAAAAAAAAAAAAAAAAAAAAAAAAAAAAAAAAAAAAAAAAAAAAAAA",
(char*)  "SBR BXE AAAAAAAAAAAAAAAAAAAAAH////////////////////+AAAAAAA",
(char*)  "SBR BbC AAAAAAAAAAAAAAAAAAAAAH//////gAAAAAAAf/////+AAAAAAA",
(char*)  "SBR BeV AAAAAAAAAAAAAAAAAAAAAH////////////////////+AAAAAAA",
(char*)  "SBR BiT AAAAAAAAAAAAAAAAAAAAAAAAAAAAAAAAAAAAAAAAAAAAAAAAAA",
(char*)  "SBR Bln AAAAAAAAAAAAAAAAAAAAAH//////////////gAAAAAAAAAAAAA",
(char*)  "SBR Bpl AAAAAAAAAAAAAAAAAAAAAAAAAAAAAAAAAAAAf/////+AAAAAAA",
(char*)  "SBR Bs5 AAAAAAAAAAAAAAAAAAAAAAAAAAAAf///////gAAAAAAAAAAAAA",
(char*)  "SBR Bw3 AAAAAAAAAAAAAAAAAAAAAAAAAAAAAAAAAAAAf/////+AAAAAAA",
(char*)  "SBR B0K AAAAAAAAAAAAAAAAAAAAAH//////////////gAAAAAAAAAAAAA",
(char*)  "SBR B4I AAAAAAAAAAAAAAAAAAAAAAAAAAAAAAAAAAAAAAAAAAAAAAAAAA",
(char*)  "SBR CCu AAAAAAB//////4AAAAAAAAAAAAAAAAAAAAAAAAAAAAAAAAAAAA",
(char*)  "SBR CJ/ AAAAAAB///////////////////////////////////+AAAAAAA",
(char*)  "SBR CN9 AAAAAAB//////4AAAAAAAAAAAAAAAAAAAAAAAAAAAAAAAAAAAA",
(char*)  "SBR CVP AAAAAAAAAAAAAAAAAAAAAAAAAAAAAAAAAAAAAAAAAAAAAAAAAA",
(char*)  "SBR CYj AAAAAAB///////////////////////////////////+AAAAAAA",
(char*)  "SBR Cch AAAAAAAAAAAAAAAAAAAAAH//////gAAAAAAAAAAAAAAAAAAAAA",
(char*)  "SBR Cf0 AAAAAAAAAAAAAAAAAAAAAH////////////////////+AAAAAAA",
(char*)  "SBR Cjy AAAAAAAAAAAAAAAAAAAAAAAAAAAAAAAAAAAAAAAAAAAAAAAAAA",
(char*)  "SBR CnG AAAAAAAAAAAAAAAAAAAAAH////////////////////+AAAAAAA",
(char*)  "SBR CrE AAAAAAAAAAAAAAAAAAAAAH//////gAAAAAAAAAAAAAAAAAAAAA",
(char*)  "SBR CuY AAAAAAAAAAAAAAAAAAAAAAAAAAAAAAAAAAAAAAAAAAAAAAAAAA",
(char*)  "SBR CyW AAAAAAAAAAAAAAAAAAAAAH////////////////////+AAAAAAA",
(char*)  "SBR C1p AAAAAAAAAAAAAAAAAAAAAAAAAAAAAAAAAAAAf/////+AAAAAAA",
(char*)  "SBR C5n AAAAAAAAAAAAAAAAAAAAAH////////////////////+AAAAAAA",
(char*)  "SBR C87 AAAAAAAAAAAAAAAAAAAAAAAAAAAAAAAAAAAAAAAAAAAAAAAAAA",
(char*)  "SBR DWE AAAAAAAAAAAAAAAAAAAAAAAAAAAAAAAAAAAAAAAAAAAAAAAAAA"
// // Eigth Note 128 lines
// (char*)  "SBR O9 AAAAAAAAAAAAAAAAAAAAAAAAAAAAAAAAAAAAAAAAAAAAAAAAAA\n",
// (char*)  "SBR BF3 AAAAAAAAAAAAAAAAAAAAAAAAAAAAAAAAAAAAAAAAAAnkAAAAAA\n",
// (char*)  "SBR BGh AAAAAAAAAAAAAAAAAAAAAAAAAAAAAAAAAAAAAAAAAD//gAAAAA\n",
// (char*)  "SBR BHM AAAAAAAAAAAAAAAAAAAAAAAAAAAAAAAAAAAAAAAAA///wAAAAA\n",
// (char*)  "SBR BH2 AAAAAAAAAAAAAAAAAAAAAAAAAAAAAAAAAAAAAAAAD///+AAAAA\n",
// (char*)  "SBR BIg AAAAAAAAAAAAAAAAAAAAAAAAAAAAAAAAAAAAAAAAP////AAAAA\n",
// (char*)  "SBR BJL AAAAAAAAAAAAAAAAAAAAAAAAAAAAAAAAAAAAAAAAf////gAAAA\n",
// (char*)  "SBR BJ1 AAAAAAAAAAAAAAAAAAAAAAAAAAAAAAAAAAAAAAAB/////4AAAA\n",
// (char*)  "SBR BKf AAAAAAAAAAAAAAAAAAAAAAAAAAAAAAAAAAAAAAAB/////8AAAA\n",
// (char*)  "SBR BLK AAAAAAAAAAAAAAAAAAAAAAAAAAAAAAAAAAAAAAAH/////8AAAA\n",
// (char*)  "SBR BL0 AAAAAAAAAAAAAAAAAAAAAAAAAAAAAAAAAAAAAAAP/////+AAAA\n",
// (char*)  "SBR BMe AAAAAAAAAAAAAAAAAAAAAAAAAAAAAAAAAAAAAAAf//////AAAA\n",
// (char*)  "SBR BNJ AAAAAAAAAAAAAAAAAAAAAAAAAAAAAAAAAAAAAAA///////gAAA\n",
// (char*)  "SBR BNz AAAAAAAAAAAAAAAAAAAAAAAAAAAAAAAAAAAAAAB///////gAAA\n",
// (char*)  "SBR BOd AAAAAAAAAAAAAAAAAAAAAAAAAAAAAAAAAAAAAAD///////gAAA\n",
// (char*)  "SBR BPI AAAAAAAAAAAAAAAAAAAAAAAAAAAAAAAAAAAAAAH///////wAAA\n",
// (char*)  "SBR BPy AAAAAAAAAAAAAAAAAAAAAAAAAAAAAAAAAAAAAAH///////4AAA\n",
// (char*)  "SBR BQc AAAAAAAAAAAAAAAAAAAAAAAAAAAAAAAAAAAAAAf///////wAAA\n",
// (char*)  "SBR BRH AAAAAAAAAAAAAAAAAAAAAAAAAAAAAAAAAAAAAAf///////4AAA\n",
// (char*)  "SBR BRx AAAAAAAAAAAAAAAAAAAAAAAAAAAAAAAAAAAAAA////////4AAA\n",
// (char*)  "SBR BSb AAAAAAAAAAAAAAAAAAAAAAAAAAAAAAAAAAAAAA////////8AAA\n",
// (char*)  "SBR BTG AAAAAAAAAAAAAAAAAAAAAAAAAAAAAAAAAAAAAB////////4AAA\n",
// (char*)  "SBR BTw AAAAAAAAAAAAAAAAAAAAAAAAAAAAAAAAAAAAAD////////8AAA\n",
// (char*)  "SBR BVF AAAAAAAAAAAAAAAAAAAAAAAAAAAAAAAAAAAAAH////////8AAA\n",
// (char*)  "SBR BVv AAAAAAAAAAAAAAAAAAAAAAAAAAAAAAAAAAAAAP////////8AAA\n",
// (char*)  "SBR BWZ AAAAAAAAAAAAAAAAAAAAAAAAAAAAAAAAAAAAAf////////8AAA\n",
// (char*)  "SBR BXu AAAAAAAAAAAAAAAAAAAAAAAAAAAAAAAAAAAAA/////////8AAA\n",
// (char*)  "SBR BZD AAAAAAAAAAAAAAAAAAAAAAAAAAAAAAAAAAAAB/////////8AAA\n",
// (char*)  "SBR BaX AAAAAAAAAAAAAAAAAAAAAAAAAAAAAAAAAAAAB/////////4AAA\n",
// (char*)  "SBR BbC AAAAAAAAAAAAAAAAAAAAAAAAAAAAAAAAAAAAD/////////8AAA\n",
// (char*)  "SBR Bbs AAAAAAAAAAAAAAAAAAAAAAAAAAAAAAAAAAAAD/////////4AAA\n",
// (char*)  "SBR BdB AAAAAAAAAAAAAAAAAAAAAAAAAAAAAAAAAAAAH/////////4AAA\n",
// (char*)  "SBR Bdr AAAAAAAAAAAAAAAAAAAAAAAAAAAAAAAAAAAAH/////////wAAA\n",
// (char*)  "SBR BeV AAAAAAAAAAAAAAAAAAAAAAAAAAAAAAAAAAAAH/////////4AAA\n",
// (char*)  "SBR BfA AAAAAAAAAAAAAAAAAAAAAAAAAAAAAAAAAAAAP/////////wAAA\n",
// (char*)  "SBR BgU AAAAAAAAAAAAAAAAAAAAAAAAAAAAAAAAAAAAf/////////gAAA\n",
// (char*)  "SBR Bg/ AAAAAAAAAAAAAAAAAAAAAAAAAAAAAAAAAAAAP/////////gAAA\n",
// (char*)  "SBR Bhp AAAAAAAAAAAAAAAAAAAAAAAAAAAAAAAAAAAAf/////////gAAA\n",
// (char*)  "SBR BiT AAAAAAAAAAAAAAAAAAAAAAAAAAAAAAAAAAAAf/////////AAAA\n",
// (char*)  "SBR BkS AAAAAAAAAAAAAAAAAAAAAAAAAAAAAAAAAAAAf////////+AAAA\n",
// (char*)  "SBR Bk9 AAAAAAAAAAAAAAAAAAAAAAAAAAAAAAAAAAAA/////////+AAAA\n",
// (char*)  "SBR BmR AAAAAAAAAAAAAAAAAAAAAAAAAAAAAAAAAAAA/////////8AAAA\n",
// (char*)  "SBR Bnm AAAAAAAAAAAAAAAAAAAAAAAAAAAAAAAAAAAA/////////4AAAA\n",
// (char*)  "SBR BoQ AAAAAAAAAAAAAAAAAAAAAAAAAAAAAAAAAAAA/////////wAAAA\n",
// (char*)  "SBR Bo7 AAAAAAAAAAAAAAAAAAAAAAAAAAAAAAAAAAAA/////////gAAAA\n",
// (char*)  "SBR Bq6 AAAAAAAAAAAAAAAAAAAAAAAAAAAAAAAAAAAAf////////AAAAA\n",
// (char*)  "SBR Brk AAAAAAAAAAAAAAAAAAAAAAAAAAAAAAAAAAAAf///////+AAAAA\n",
// (char*)  "SBR BsO AAAAAAAAAAAAAAAAAAAAAAAAAAAAAAAAAAAAf///////8AAAAA\n",
// (char*)  "SBR Bs5 AAAAAAAAAAAAAAAAAAAAAAAAAAAAAAAAAAAAf///////4AAAAA\n",
// (char*)  "SBR BuN AAAAAAAAAAAAAAAAAAAAAAAAAAAAAAAAAAAAP///////wAAAAA\n",
// (char*)  "SBR Bu4 AAAAAAAAAAAAAAAAAAAAAAAAAAAAAAAAAAAAP///////gAAAAA\n",
// (char*)  "SBR Bvi AAAAAAAAAAAAAAAAAAAAAAAAAAAAAAAAAAAAH///////AAAAAA\n",
// (char*)  "SBR BwM AAAAAAAAAAAAAAAAAAAAAAAAAAAAAAAAAAAAH//////+AAAAAA\n",
// (char*)  "SBR Bw3 AAAAAAAAAAAAAAAAAAAAAAAAAAAAAAAAAAAAH//////8AAAAAA\n",
// (char*)  "SBR Bxh AAAAAAAAAAAAAAAAAAAAAAAAAAAAAAAAAAAAH//////4AAAAAA\n",
// (char*)  "SBR ByL AAAAAAAAAAAAAAAAAAAAAAAAAAAAAAAAAAAAD//////wAAAAAA\n",
// (char*)  "SBR By2 AAAAAAAAAAAAAAAAAAAAAAAAAAAAAAAAAAAAB//////gAAAAAA\n",
// (char*)  "SBR Bzg AAAA//////////////////////////////////////+AAAAAAA\n",
// (char*)  "SBR B0K AAAA//////////////////////////////////////8AAAAAAA\n",
// (char*)  "SBR B01 AAAA//////////////////////////////////////4AAAAAAA\n",
// (char*)  "SBR B1f AAAA//////////////////////////////////////AAAAAAAA\n",
// (char*)  "SBR B2J AAAA/////////////////////////////////////+AAAAAAAA\n",
// (char*)  "SBR B20 AAAA/////////////////////////////////////wAAAAAAAA\n",
// (char*)  "SBR B3e AAAA/////////////////////////////////////gAAAAAAAA\n",
// (char*)  "SBR B4I AAAA////////////////////////////////////6AAAAAAAAA\n",
// (char*)  "SBR B4z AAAA////////////////////////////////////AAAAAAAAAA\n",
// (char*)  "SBR B5d AAAAAAn////////+AAAAAAAAAAAAAAAAAAAAAAAAAAAAAAAAAA\n",
// (char*)  "SBR B6H AAAAAAAv///////+AAAAAAAAAAAAAAAAAAAAAAAAAAAAAAAAAA\n",
// (char*)  "SBR B6y AAAAAAAA///////8AAAAAAAAAAAAAAAAAAAAAAAAAAAAAAAAAA\n",
// (char*)  "SBR B7c AAAAAAAAP//////+AAAAAAAAAAAAAAAAAAAAAAAAAAAAAAAAAA\n",
// (char*)  "SBR B8G AAAAAAAAA//////+AAAAAAAAAAAAAAAAAAAAAAAAAAAAAAAAAA\n",
// (char*)  "SBR B8x AAAAAAAAAf//////AAAAAAAAAAAAAAAAAAAAAAAAAAAAAAAAAA\n",
// (char*)  "SBR B9b AAAAAAAAAH//////AAAAAAAAAAAAAAAAAAAAAAAAAAAAAAAAAA\n",
// (char*)  "SBR B+F AAAAAAAAAB//////AAAAAAAAAAAAAAAAAAAAAAAAAAAAAAAAAA\n",
// (char*)  "SBR B+w AAAAAAAAAAf/////AAAAAAAAAAAAAAAAAAAAAAAAAAAAAAAAAA\n",
// (char*)  "SBR B/a AAAAAAAAAAP/////gAAAAAAAAAAAAAAAAAAAAAAAAAAAAAAAAA\n",
// (char*)  "SBR CAE AAAAAAAAAAD/////wAAAAAAAAAAAAAAAAAAAAAAAAAAAAAAAAA\n",
// (char*)  "SBR CAv AAAAAAAAAAB/////wAAAAAAAAAAAAAAAAAAAAAAAAAAAAAAAAA\n",
// (char*)  "SBR CBZ AAAAAAAAAAAf////wAAAAAAAAAAAAAAAAAAAAAAAAAAAAAAAAA\n",
// (char*)  "SBR CCD AAAAAAAAAAAH////wAAAAAAAAAAAAAAAAAAAAAAAAAAAAAAAAA\n",
// (char*)  "SBR CCu AAAAAAAAAAAH////4AAAAAAAAAAAAAAAAAAAAAAAAAAAAAAAAA\n",
// (char*)  "SBR CDY AAAAAAAAAAAB////4AAAAAAAAAAAAAAAAAAAAAAAAAAAAAAAAA\n",
// (char*)  "SBR CEC AAAAAAAAAAAA////8AAAAAAAAAAAAAAAAAAAAAAAAAAAAAAAAA\n",
// (char*)  "SBR CEt AAAAAAAAAAAAf///8AAAAAAAAAAAAAAAAAAAAAAAAAAAAAAAAA\n",
// (char*)  "SBR CFX AAAAAAAAAAAAH///+AAAAAAAAAAAAAAAAAAAAAAAAAAAAAAAAA\n",
// (char*)  "SBR CGB AAAAAAAAAAAAH////AAAAAAAAAAAAAAAAAAAAAAAAAAAAAAAAA\n",
// (char*)  "SBR CGs AAAAAAAAAAAAD////AAAAAAAAAAAAAAAAAAAAAAAAAAAAAAAAA\n",
// (char*)  "SBR CHW AAAAAAAAAAAAA////gAAAAAAAAAAAAAAAAAAAAAAAAAAAAAAAA\n",
// (char*)  "SBR CIA AAAAAAAAAAAAAf///wAAAAAAAAAAAAAAAAAAAAAAAAAAAAAAAA\n",
// (char*)  "SBR CIr AAAAAAAAAAAAAP///wAAAAAAAAAAAAAAAAAAAAAAAAAAAAAAAA\n",
// (char*)  "SBR CJV AAAAAAAAAAAAAD///wAAAAAAAAAAAAAAAAAAAAAAAAAAAAAAAA\n",
// (char*)  "SBR CJ/ AAAAAAAAAAAAAB///4AAAAAAAAAAAAAAAAAAAAAAAAAAAAAAAA\n",
// (char*)  "SBR CKq AAAAAAAAAAAAAB///8AAAAAAAAAAAAAAAAAAAAAAAAAAAAAAAA\n",
// (char*)  "SBR CLU AAAAAAAAAAAAAA///8AAAAAAAAAAAAAAAAAAAAAAAAAAAAAAAA\n",
// (char*)  "SBR CL+ AAAAAAAAAAAAAAP///AAAAAAAAAAAAAAAAAAAAAAAAAAAAAAAA\n",
// (char*)  "SBR CMp AAAAAAAAAAAAAAH///AAAAAAAAAAAAAAAAAAAAAAAAAAAAAAAA\n",
// (char*)  "SBR CNT AAAAAAAAAAAAAAD///gAAAAAAAAAAAAAAAAAAAAAAAAAAAAAAA\n",
// (char*)  "SBR CN9 AAAAAAAAAAAAAAB///gAAAAAAAAAAAAAAAAAAAAAAAAAAAAAAA\n",
// (char*)  "SBR COo AAAAAAAAAAAAAAAf//4AAAAAAAAAAAAAAAAAAAAAAAAAAAAAAA\n",
// (char*)  "SBR CPS AAAAAAAAAAAAAAAf//8AAAAAAAAAAAAAAAAAAAAAAAAAAAAAAA\n",
// (char*)  "SBR CP8 AAAAAAAAAAAAAAAP//8AAAAAAAAAAAAAAAAAAAAAAAAAAAAAAA\n",
// (char*)  "SBR CQn AAAAAAAAAAAAAAAD///AAAAAAAAAAAAAAAAAAAAAAAAAAAAAAA\n",
// (char*)  "SBR CRR AAAAAAAAAAAAAAAB///gAAAAAAAAAAAAAAAAAAAAAAAAAAAAAA\n",
// (char*)  "SBR CR7 AAAAAAAAAAAAAAAAf//gAAAAAAAAAAAAAAAPAAAAAAAAAAAAAA\n",
// (char*)  "SBR CSm AAAAAAAAAAAAAAAAf//4AAAAAAAAAAAAAAAeAAAAAAAAAAAAAA\n",
// (char*)  "SBR CTQ AAAAAAAAAAAAAAAAH//+AAAAAAAAAAAAAAH8AAAAAAAAAAAAAA\n",
// (char*)  "SBR CT6 AAAAAAAAAAAAAAAAD//+AAAAAAAAAAAAAAPwAAAAAAAAAAAAAA\n",
// (char*)  "SBR CUl AAAAAAAAAAAAAAAAB///wAAAAAAAAAAAAD/gAAAAAAAAAAAAAA\n",
// (char*)  "SBR CVP AAAAAAAAAAAAAAAAAf//4AAAAAAAAAAAAf/AAAAAAAAAAAAAAA\n",
// (char*)  "SBR CV5 AAAAAAAAAAAAAAAAAP//+AAAAAAAAAAAB/8AAAAAAAAAAAAAAA\n",
// (char*)  "SBR CWk AAAAAAAAAAAAAAAAAH///AAAAAAAAAAAP/wAAAAAAAAAAAAAAA\n",
// (char*)  "SBR CXO AAAAAAAAAAAAAAAAAB///4AAAAAAAAAAf/AAAAAAAAAAAAAAAA\n",
// (char*)  "SBR CX4 AAAAAAAAAAAAAAAAAA////AAAAAAAAAD/wAAAAAAAAAAAAAAAA\n",
// (char*)  "SBR CYj AAAAAAAAAAAAAAAAAAP///4AAAAAAAA//AAAAAAAAAAAAAAAAA\n",
// (char*)  "SBR CZN AAAAAAAAAAAAAAAAAAH///9AAAAAAAH/+AAAAAAAAAAAAAAAAA\n",
// (char*)  "SBR CZ3 AAAAAAAAAAAAAAAAAAA////oAAAAAAf/gAAAAAAAAAAAAAAAAA\n",
// (char*)  "SBR Cai AAAAAAAAAAAAAAAAAAAf///+gAAAAL/8AAAAAAAAAAAAAAAAAA\n",
// (char*)  "SBR CbM AAAAAAAAAAAAAAAAAAAH////9AAAF//4AAAAAAAAAAAAAAAAAA\n",
// (char*)  "SBR Cb2 AAAAAAAAAAAAAAAAAAAD/////+/8///AAAAAAAAAAAAAAAAAAA\n",
// (char*)  "SBR Cch AAAAAAAAAAAAAAAAAAAAf/////////4AAAAAAAAAAAAAAAAAAA\n",
// (char*)  "SBR CdL AAAAAAAAAAAAAAAAAAAAH////////9AAAAAAAAAAAAAAAAAAAA\n",
// (char*)  "SBR Cd1 AAAAAAAAAAAAAAAAAAAAB////////gAAAAAAAAAAAAAAAAAAAA\n",
// (char*)  "SBR Ceg AAAAAAAAAAAAAAAAAAAAAP//////6AAAAAAAAAAAAAAAAAAAAA\n",
// (char*)  "SBR CfK AAAAAAAAAAAAAAAAAAAAABf////+gAAAAAAAAAAAAAAAAAAAAA\n",
// (char*)  "SBR Cf0 AAAAAAAAAAAAAAAAAAAAAAF////QAAAAAAAAAAAAAAAAAAAAAA\n",
// (char*)  "SBR Cgf AAAAAAAAAAAAAAAAAAAAAAACP+QAAAAAAAAAAAAAAAAAAAAAAA",
// (char*)  "SBR ChJ AAAAAAAAAAAAAAAAAAAAAAAAAAAAAAAAAAAAAAAAAAAAAAAAAA",
// (char*)  "SBR DWE AAAAAAAAAAAAAAAAAAAAAAAAAAAAAAAAAAAAAAAAAAAAAAAAAA"

// (char*) "SBR O9 AAAAAAAAAAAAAAAAAAAAAAAAAAAAAAAAAAAAAAAAAAAAAAAAAA",  // KSU logo, small, 244 lines
// (char*) "SBR bi AAAf//////////////////8AAAAAAAAAAAAAAAAAAAAAAAAAAA",
// (char*) "SBR cM AAAf//////////////////4AAAAAAAAAAAAAAAAAAAAAAAAAAA",
// (char*) "SBR c2 AAA///////////////////wAAAAAAAAAAAAAAAAAAAAAAAAAAA",
// (char*) "SBR dh AAA///////////////////gAAAAAAAAAAAAAAAAAAAAAAAAAAA",
// (char*) "SBR eL AAA///////////////////AAAAAAAAAAAAAAAAAAAAAAAAAAAA",
// (char*) "SBR e1 AAB//////////////////+AAAAAAAAAAAAAAAAAAAAAAAAAAAA",
// (char*) "SBR fg AAB//////////////////8AAAAAAAAAAAAAAAAAAAAAAAAAAAA",
// (char*) "SBR gK AAB//////////////////4AAAAAAAAAAAAAAAAAAAAAAAAAAAA",
// (char*) "SBR g0 AAB//////////////////gAAAAAAAAAAAAAAAAAAAAAAAAAAAA",
// (char*) "SBR hf AAD//////////////////AAAAAAAAAAAAAAAAAAAAAAAAAAAAA",
// (char*) "SBR iJ AAD/////////////////+AAAAAAAAAAAAAAAAAAAAAAAAAAAAA",
// (char*) "SBR iz AAD/////////////////8AAAAAAAAAAAAAAAAAAAAAAAAAAAAA",
// (char*) "SBR je AAH/////////////////4AAAAAAAAAAAAAAAAAAAAAAAAAAAAA",
// (char*) "SBR ky AAH/////////////////wAAAAAAAAAAAAAAAAAAAAAAAAAAAAA",
// (char*) "SBR ld AAP/////////////////gAAAAAAAAAAAAAAAAAAAAAAAAAAAAA",
// (char*) "SBR mH AAP/////////////////AAAAAAAAAAAAAAAAAAAAAAAAAAAAAA",
// (char*) "SBR mx AAP////////////////+AAAAAAAAAAAAAAAAAAAAAAAAAAAAAA",
// (char*) "SBR nc AAf////////////////8AAAAAAAAAAAAAAAAAAAAAAAAAAAAAA",
// (char*) "SBR oG AAf////////////////4AAAAAAAAAAAAAAAAAAAAAAAAAAAAAA",
// (char*) "SBR ow AAf////////////////wAAAAAAAAAAAAAAAAAAAAAAAAAAAAAA",
// (char*) "SBR pb AA/////////////////gAAAAAAAAAAAAAAAAAAAAAAAAAAAAAA",
// (char*) "SBR qv AB/////////////////AAAAAAAAAAAAAAAAAAAAAAAAAAAAAAA",
// (char*) "SBR ra AB////////////////+AAAAD//8AAAAAAAAAAAAAAAAAAAAAAA",
// (char*) "SBR sE AB////////////////+AAAA////wAAAAAAAAAAAAAAAAAAAAAA",
// (char*) "SBR su AD////////////////8AAAH////+AAAAAAAAAAAAAAAAAAAAAA",
// (char*) "SBR tZ AD////////////////4AAAf/////AAAAAAAAAAAAAAAAAAAAAA",
// (char*) "SBR uD AD////////////////wAAB//////wAAAAAAAAAAAAAAAAAAAAA",
// (char*) "SBR ut AB////////////////gAAH//////4AAAAAAAAAAAAAAAAAAAAA",
// (char*) "SBR vY AAf///////////////gAAP//////+AAAAAAAAAAAAAAAAAAAAA",
// (char*) "SBR wC AAP///////////////AAA////////gAAAAAAAAAAAAAAAAAAAA",
// (char*) "SBR ws AAH//////////////+AAB////////wAAAAAAAAAAAAAAAAAAAA",
// (char*) "SBR xX AAD//////////////+AAH////////4AAAAAAAAAAAAAAAAAAAA",
// (char*) "SBR yB AAB//////////////8AAP////////+AAAAAAAAAAAAAAAAAAAA",
// (char*) "SBR yr DAA//////////////8AAf/////////AAAAAAAAAAAAAAAAAAAA",
// (char*) "SBR zW DgAf/////////////4AA//////////gAAAAAAAAAAAAAAAAAAA",
// (char*) "SBR 0A DwAP/////////////wAB//////////wAAAAAAAAAAAAAAAAAAA",
// (char*) "SBR 0q D4AH/////////////wAD//////////4AAAAAAAAAAAAAAAAAAA",
// (char*) "SBR 1V D8AD/////////////gAH//////////8AAAAAAAAAAAAAAAAAAA",
// (char*) "SBR 1/ D+AD/////////////gAP//////////+AAAAAAAAAAAAAAAAAAA",
// (char*) "SBR 2p D/AB/////////////AAf///////////AAAAAAAAAAAAAAAAAAA",
// (char*) "SBR 3U D/gA////////////+AA////////////gAAAAAAAAAAAAAAAAAA",
// (char*) "SBR 3+ D/wAf///////////+AB////////////wAAAAAAAAAAAAAAAAAA",
// (char*) "SBR 4o D/4Af///////////8AB////////////wAAAAAAAAAAAAAAAAAA",
// (char*) "SBR 5T D/8AP///////////8AD////////////4AAAAAAAAAAAAAAAAAA",
// (char*) "SBR 59 D/+AH///////////4AD////////////8AAAAAAAAAAAAAAAAAA",
// (char*) "SBR 6n D//AH///////////4AH////////////+AAAAAAAAAAAAAAAAAA",
// (char*) "SBR 7S D//gD///////////wAP////////////+AAAAAAAAAAAAAAAAAA",
// (char*) "SBR 78 D//gD///////////wAP/////////////AAAAAAAAAAAAAAAAAA",
// (char*) "SBR 8m D//wB///////////wAf/////////////AAAAAAAAAAAAAAAAAA",
// (char*) "SBR 9R D//4A///////////gA//////////////gAAAAAAAAAAAAAAAAA",
// (char*) "SBR +l D//8Af//////////AB//////////////wAAAAAAAAAAAAAAAAA",
// (char*) "SBR /6 D//+AP/////////+AD//////////////4AAAAAAAAAAAAAAAAA",
// (char*) "SBR BAk D//+AP/////////+AH//////////////4AAAAAAAAAAAAAAAAA",
// (char*) "SBR BBP D///AH/////////+AH//////////////4AAAAAAAAAAAAAAAAA",
// (char*) "SBR BB5 D///AH/////////8AH//////////////8AAAAAAAAAAAAAAAAA",
// (char*) "SBR BCj D///gH/////////8AP//////////////8AAAAAAAAAAAAAAAAA",
// (char*) "SBR BDO D///gD/////////4AP//////////////8AAAAAAAAAAAAAAAAA",
// (char*) "SBR BD4 D///wD/////////4Af//////////////+AAAAAAAAAAAAAAAAA",
// (char*) "SBR BFN D///wD/////////wAf//////////////+AAAAAAAAAAAAAAAAA",
// (char*) "SBR BF3 D///4B/////////wA////////////////AAAAAAAAAAAAAAAAA",
// (char*) "SBR BGh D///4B/////////gA////////////////AAAAAAAAAAAAAAAAA",
// (char*) "SBR BH2 D///4B/////////gB////////////////AAAAAAAAAAAAAAAAA",
// (char*) "SBR BIg D///8B/////////gB////////////////AAAAAAAAAAAAAAAAA",
// (char*) "SBR BJL D///8B/////////AD////////////////gAAAAAAAAAAAAAAAA",
// (char*) "SBR BLK D///8A/////////AH////////////////gAAAAAAAAAAAAAAAA",
// (char*) "SBR BL0 D///8A////////+AH////////////////gAAAAAAAAAAAAAAAA",
// (char*) "SBR BNz D///8A////////+AP////////////////gAAAAAAAAAAAAAAAA",
// (char*) "SBR BOd D///8A////////+AP////////////////wAAAAAAAAAAAAAAAA",
// (char*) "SBR BPI D///8A////////8AP////////////////wAAAAAAAAAAAAAAAA",
// (char*) "SBR BPy D///8B////////8AP////////////////wAAAAAAAAAAAAAAAA",
// (char*) "SBR BQc D///8B////////8Af////////////////wAAAAAAAAAAAAAAAA",
// (char*) "SBR BRH D///8B////////8Af////////////////gAAAAAAAAAAAAAAAA",
// (char*) "SBR BRx D///8B////////4Af/////////AH/////gAAAAAAAAAAAAAAAA",
// (char*) "SBR BSb D///8B////////4Af////////gAAH////gAAAAAAAAAAAAAAAA",
// (char*) "SBR BTG D///4B////////4Af///////8AAAAf///gAAAAAAAAAAAAAAAA",
// (char*) "SBR BTw D///4B////////4A////////gAAAAH///gAAAAAAAAAAAAAAAA",
// (char*) "SBR BUa D///4D////////4A///////+AAAAAA///gAAAAAAAAAAAAAAAA",
// (char*) "SBR BVF D///wD////////wA///////4AAAAAAP//gAAAAAAAAAAAAAAAA",
// (char*) "SBR BVv D///wD////////wA///////gAAAAAAH//gAAAAAAAAAAAAAAAA",
// (char*) "SBR BWZ D///wH////////wA//////+AAAAAAAB//gAAAAAAAAAAAAAAAA",
// (char*) "SBR BXE D///gH////////wA//////4AAAAAAAAf/AAAAAAAAAAAAAAAAA",
// (char*) "SBR BXu D///AP////////wA//////gAAAAAAAAH/AAAAAAAAAAAAAAAAA",
// (char*) "SBR BYY D//+AP////////wB//////AAAAAAAAAD/AAAAAAAAAAAAAAAAA",
// (char*) "SBR BZD D//8Af////////wB/////8AAAAAAAAAA/AAAAAAAAAAAAAAAAA",
// (char*) "SBR BZt D//4Af////////gB/////4AAAAAAAAAAfAAAAAAAAAAAAAAAAA",
// (char*) "SBR BaX D//wA/////////gB/////wAAAAAAAAAAOAAAAAAAAAAAAAAAAA",
// (char*) "SBR BbC D//gB/////////gB/////gAAAAAAAAAAGAAAAAAAAAAAAAAAAA",
// (char*) "SBR Bbs D/+AD/////////gB/////AAAAAAAAAAACAAAAAAAAAAAAAAAAA",
// (char*) "SBR BcW D/4AH/////////gB////+AAAAAAAAAAAAAAAAAAAAAAAAAAAAA",
// (char*) "SBR BdB D8AAP/////////gB////8AAAAAAAAAAAAAAAAAAAAAAAAAAAAA",
// (char*) "SBR Bdr AAAAf/////////gB////4AAAAAAAAAAAAAAAAAAAAAAAAAAAAA",
// (char*) "SBR BeV AAAA//////////gB////wAAAAAAAAAAAAAAAAAAAAAAAAAAAAA",
// (char*) "SBR BfA AAAB//////////gB////gAAAAAAAAAAAAAAAAAAAAAAAAAAAAA",
// (char*) "SBR Bfq AAAH//////////gD////gAAAAAAAAAAAAAAAAAAAAAAAAAAAAA",
// (char*) "SBR BgU AAAf//////////gD////AAAAAAAAAAAAAAAAAAAAAAAAAAAAAA",
// (char*) "SBR Bg/ AAD///////////AD///+AAAAAAAAAAAAAAAAAAAAAAAAAAAAAA",
// (char*) "SBR Bhp AB////////////AD///+AAAAAAAAAAAAAAAAAAAAAAAAAAAAAA",
// (char*) "SBR BiT H/////////////AD///8AAAAAAAAAAAAAAAAAAAAAAAAAAAAAA",
// (char*) "SBR Bi+ H/////////////AD///4AAAAAAAAAAAAAAAAAAAAAAAAAAAAAA",
// (char*) "SBR BkS H/////////////AD///wAAAAAAAAAAAAAAAAAAAAAAAAAAAAAA",
// (char*) "SBR Bln H/////////////AD///gAAAAAAAAAAAAAAAAAAAAAAAAAAAAAA",
// (char*) "SBR BmR H/////////////AD///gAAAAP/4AAAAAAAAAAAAAAAAAAAAAAA",
// (char*) "SBR Bm8 H/////////////AD///gAAAB///gAAAAAAAAAAAAAAAAAAAAAA",
// (char*) "SBR Bnm H/////////////AD///AAAAP///8AAAAAAAAAAAAAAAAAAAAAA",
// (char*) "SBR BoQ P/////////////AD///AAAA/////AAAAAAAAAAAAAAAAAAAAAA",
// (char*) "SBR Bo7 P/////////////AD///AAAD/////wAAAAAAAAAAAAAAAAAAAAA",
// (char*) "SBR Bpl P/////////////AD//+AAAH/////8AAAAAAAAAAAAAAAAAAAAA",
// (char*) "SBR BqP P/////////////AD//+AAAP/////+AAAAAAAAAAAAAAAAAAAAA",
// (char*) "SBR Bq6 P/////////////AD//8AAAf//////gAAAAAAAAAAAAAAAAAAAA",
// (char*) "SBR Brk P/////////////AD//8AAA///////wAAAAAAAAAAAAAAAAAAAA",
// (char*) "SBR BsO P/////////////AD//8AAB///////4AAAAAAAAAAAAAAAAAAAA",
// (char*) "SBR Bs5 P/////////////gD//4AAD///////8AAAAAAAAAAAAAAAAAAAA",
// (char*) "SBR Btj P/////////////gD//4AAH////////AAAAAAAAAAAAAAAAAAAA",
// (char*) "SBR BuN P/////////////gD//4AAP////////gAAAAAAAAAAAAAAAAAAA",
// (char*) "SBR Bu4 P/////////////gD//4AAf///////+AAAAAAAAAAAAAAAAAAAA",
// (char*) "SBR Bvi P/////////////gD//wAA////////4AAAAAAAAAAAAAAAAAAAA",
// (char*) "SBR BwM P/////////////gD//wAB////////wAAAAAAAAAAAAAAAAAAAA",
// (char*) "SBR Bw3 P/////////////gD//wAB////////gAAAAAAAAAAAAAAAAAAAA",
// (char*) "SBR Bxh P/////////////gD//wAD////////AAAAAAAAAAAAAAAAAAAAA",
// (char*) "SBR ByL P/////////////gD//wAH///////+AAAAAAAAAAAAAAAAAAAAA",
// (char*) "SBR By2 P/////////////gD//gAH///////8AAAAAAAAAAAAAAAAAAAAA",
// (char*) "SBR Bzg P/////////////gD//gAP///////4AAAAAAAAAAAAAAAAAAAAA",
// (char*) "SBR B0K P/////////////gD//gAP///////wAAAAAAAAAAAAAAAAAAAAA",
// (char*) "SBR B01 P/////////////wD//gAf///////wAAAAAAAAAAAAAAAAAAAAA",
// (char*) "SBR B1f P/////////////wB//gAf///////gAAAAAAAAAAAAAAAAAAAAA",
// (char*) "SBR B2J P/////////////wB//gAf///////AAAAAAAAAAAAAAAAAAAAAA",
// (char*) "SBR B20 H/////////////wB//gA////////AAAAAAAAAAAAAAAAAAAAAA",
// (char*) "SBR B3e H/////////////wB//gA///////+AAAAAAAAAAAAAAAAAAAAAA",
// (char*) "SBR B4z H/////////////wB//gA///////8AAAAAAAAAAAAAAAAAAAAAA",
// (char*) "SBR B5d H/////////////4B//gB///////8AAAAAAAAAAAAAAAAAAAAAA",
// (char*) "SBR B6y H/////////////4B//gB///////4AAAAAAAAAAAAAAAAAAAAAA",
// (char*) "SBR B7c H/////////////4B//AB///////4AAAAAAAAAAAAAAAAAAAAAA",
// (char*) "SBR B8x H/////////////8A//AD///////wAAAAAAAAAAAAAAAAAAAAAA",
// (char*) "SBR B+F D/////////////8A//gD///////wAAAAAAAAAAAAAAAAAAAAAA",
// (char*) "SBR CAv D/////////////+A//gD///////wAAAAAAAAAAAAAAAAAAAAAA",
// (char*) "SBR CBZ D/////////////+Af/gD///////wAAAAAAAAAAAAAAAAAAAAAA",
// (char*) "SBR CCu B/////////////+Af/gD///////wAAAAAAAAAAAAAAAAAAAAAA",
// (char*) "SBR CDY B/////////////+Af/gD///////4AAAAAAAAAAAAAAAAAAAAAA",
// (char*) "SBR CEC B//////////////Af/gD///////4AAAAAAAAAAAAAAAAAAAAAA",
// (char*) "SBR CFX B//////////////AP/gD///////8AAAAAAAAAAAAAAAAAAAAAA",
// (char*) "SBR CGs A//////////////AP/wD///////8AAAAAAAAAAAAAAAAAAAAAA",
// (char*) "SBR CHW A//////////////gP/wD///////+AAAAAAAAAAAAAAAAAAAAAA",
// (char*) "SBR CIA A//////////////gH/wB///////+AAAAAAAAAAAAAAAAAAAAAA",
// (char*) "SBR CIr A//////////////gH/wB////////AAAAAAAAAAAAAAAAAAAAAA",
// (char*) "SBR CJ/ Af/////////////wH/wB////////gAAAAAAAAAAAAAAAAAAAAA",
// (char*) "SBR CKq Af/////////////wD/4B////////wAAAAAAAAAAAAAAAAAAAAA",
// (char*) "SBR CLU Af/////////////wD/4B////////4AAAAAAAAAAAAAAAAAAAAA",
// (char*) "SBR CL+ Af/////////////4D/4A////////8AAAAAAAAAAAAAAAAAAAAA",
// (char*) "SBR CMp AP/////////////4B/4A////////+AAAAAAAAAAAAAAAAAAAAA",
// (char*) "SBR CNT AP/////////////4B/4AP////////AAAAAAAAAAAAAAAAAAAAA",
// (char*) "SBR CN9 AP/////////////8B8AAB////////gAAAAAAAAAAAAAAAAAAAA",
// (char*) "SBR COo AP/////////////8BgAAAf///////wAAAAAAAAAAAAAAAAAAAA",
// (char*) "SBR CPS AH/////////////8AAAAAH///////4AAAAAAAAAAAAAAAAAAAA",
// (char*) "SBR CP8 AH/////////////+AAAAAD///////8AAAAAAAAAAAAAAAAAAAA",
// (char*) "SBR CQn AH/////////////+AAAAAB////////AAAAAAAAAAAAAAAAAAAA",
// (char*) "SBR CRR AH//////////////AAAAAA///////+AAAAAAAAAAAAAAAAAAAA",
// (char*) "SBR CR7 AH//////////////AAAAAAf//////+AAAAAAAAAAAAAAAAAAAA",
// (char*) "SBR CSm AD/////////////8AAAAAAH//////+AAAAAAAAAAAAAAAAAAAA",
// (char*) "SBR CTQ AD/f///////////wAAAAAAH//////8AAAAAAAAAAAAAAAAAAAA",
// (char*) "SBR CT6 AD+f///////////gAAAAAAD//////8AAAAAAAAAAAAAAAAAAAA",
// (char*) "SBR CUl AB+f///////////AAAAAAAB//////8AAAAAAAAAAAAAAAAAAAA",
// (char*) "SBR CVP AB+P//////////+AAAAAAAB//////4AAAAAAAAAAAAAAAAAAAA",
// (char*) "SBR CV5 AB+P//////////8AAAAAAAA//////4AAAAAAAAAAAAAAAAAAAA",
// (char*) "SBR CWk AA+P//////////4AAAAAAAA//////4AAAAAAAAAAAAAAAAAAAA",
// (char*) "SBR CXO AA+P//////////4AAAAAAAA//////wAAAAAAAAAAAAAAAAAAAA",
// (char*) "SBR CX4 AAeP//////////wAAAAAAAA//////wAAAAAAAAAAAAAAAAAAAA",
// (char*) "SBR CYj AAeP//////////gAAAAAAAA//////gAAAAAAAAAAAAAAAAAAAA",
// (char*) "SBR CZN AAeH//////////AAAAAAAAA//////gAAAAAAAAAAAAAAAAAAAA",
// (char*) "SBR CZ3 AAOH/////////+AAAAAAAAA//////AAAAAAAAAAAAAAAAAAAAA",
// (char*) "SBR Cai AAOH/////////8AAAAAAAAA/////+AAAAAAAAAAAAAAAAAAAAA",
// (char*) "SBR CbM AAGH/////////8AAAAAAAAA/////+AAAAAAAAAAAAAAAAAAAAA",
// (char*) "SBR Cb2 AAGD/////////4AAAAAAAAA/////8AAAAAAAAAAAAAAAAAAAAA",
// (char*) "SBR Cch AACD/////////4AAAAAAAAA/////4AAAAAAAAAAAAAAAAAAAAA",
// (char*) "SBR CdL AACD/////////4AAAAAAAAA/////wAAAAAAAAAAAAAAAAAAAAA",
// (char*) "SBR Cd1 AACD/////////wAAAAAAAAB/////wAAAAAAAAAAAAAAAAAAAAA",
// (char*) "SBR Ceg AAAB/////////wAAAAAAAAB/////gAAAAAAAAAAAAAAAAAAAAA",
// (char*) "SBR CfK AAAB/////////wAAAAAAAAB/////AAAAAAAAAAAAAAAAAAAAAA",
// (char*) "SBR Cf0 AAAB/////////gAAAAAAAAB////+AAAAAAAAAAAAAAAAAAAAAA",
// (char*) "SBR Cgf AAAB/////////gAAAAAAAAD////+AAAAAAAAAAAAAAAAAAAAAA",
// (char*) "SBR ChJ AAAA/////////gAAAAAAAAD////8AAAAAAAAAAAAAAAAAAAAAA",
// (char*) "SBR Chz AAAA/////////gAAAAAAAAD////4AAAAAAAAAAAAAAAAAAAAAA",
// (char*) "SBR Cie AAAA/////////AAAAAAAAAH////wAAAAAAAAAAAAAAAAAAAAAA",
// (char*) "SBR CjI AAAA/////////AAAAAAAAAP////gAAAAAAAAAAAAAAAAAAAAAA",
// (char*) "SBR Cjy AAAAf////////AAAAAAAAAP////AAAAAAAAAAAAAAAAAAAAAAA",
// (char*) "SBR Ckd AAAAf////////AAAAAAAAAf///+AAAAAAAAAAAAAAAAAAAAAAA",
// (char*) "SBR ClH AAAAf////////AAAAAAAAA////8AAAAAAAAAAAAAAAAAAAAAAA",
// (char*) "SBR Clx AAAAf////////gAAAAAAAA////4AAAAAAAAAAAAAAAAAAAAAAA",
// (char*) "SBR Cmc AAAAP////////gAAAAAAAB////wAAAAAAAAAAAAAAAAAAAAAAA",
// (char*) "SBR CnG AAAAP////////gAAAAAAAD////gAAAAAAAAAAAAAAAAAAAAAAA",
// (char*) "SBR Cnw AAAAP////////gAAAAAAAH////AAAAAAAAAAAAAAAAAAAAAAAA",
// (char*) "SBR Cob AAAAP////////wAAAAAAAP///+AAAAAAAAAAAAAAAAAAAAAAAA",
// (char*) "SBR CpF AAAAH////////wAAAAAAAf///8AAAAAAAAAAAAAAAAAAAAAAAA",
// (char*) "SBR Cpv AAAAH////////wAAAAAAA/+P/4AAAAAAAAAAAAAAAAAAAAAAAA",
// (char*) "SBR Cqa AAAAH////////wAAAAAAD/wH/wAAAAAAAAAAAAAAAAAAAAAAAA",
// (char*) "SBR CrE AAAAH////////4AAAAAAH8AD/AAAAAAAAAAAAAAAAAAAAAAAAA",
// (char*) "SBR Cru AAAAD////////4AAAAAAAAAB+AAAAAAAAAAAAAAAAAAAAAAAAA",
// (char*) "SBR CsZ AAAAD////////4AAAAAAAAAA8AAAAAAAAAAAAAAAAAAAAAAAAA",
// (char*) "SBR CtD AAAAD////////8AAAAAAAAAAYAAAAAAAAAAAAAAAAAAAAAAAAA",
// (char*) "SBR Ctt AAAAB////////8AAAAAAAAAAAAAAAAAAAAAAAAAAAAAAAAAAAA",
// (char*) "SBR CuY AAAAB////////+AAAAAAAAAAAAAAAAAAAAAAAAAAAAAAAAAAAA",
// (char*) "SBR CvC AAAAB/////////AAAAAAAAAAAAAAAAAAAAAAAAAAAAAAAAAAAA",
// (char*) "SBR Cvs AAAAA/////////gAAAAAAAAAAAAAAAAAAAAAAAAAAAAAAAAAAA",
// (char*) "SBR CwX AAAAA/////////wAAAAAAAAAAAAAAAAAAAAAAAAAAAAAAAAAAA",
// (char*) "SBR CxB AAAAAf////////4AAAAAAAAAAAAAAAAAAAAAAAAAAAAAAAAAAA",
// (char*) "SBR Cxr AAAAAf////////+AAAAAAAAAAAAAAAAAAAAAAAAAAAAAAAAAAA",
// (char*) "SBR CyW AAAAAf/////////gAEAAAAAAAAAAAAAAAAAAAAAAAAAAAAAAAA",
// (char*) "SBR CzA AAAAAP/////////8B8AAAAAAAAAAAAAAAAAAAAAAAAAAAAAAAA",
// (char*) "SBR Czq AAAAAP///////////4AAAAAAAAAAAAAAAAAAAAAAAAAAAAAAAA",
// (char*) "SBR C0V AAAAAH///////////wAAAAAAAAAAAAAAAAAAAAAAAAAAAAAAAA",
// (char*) "SBR C0/ AAAAAH///////////gAAAAAAAAAAAAAAAAAAAAAAAAAAAAAAAA",
// (char*) "SBR C1p AAAAAH///////////AAAAAAAAAAAAAAAAAAAAAAAAAAAAAAAAA",
// (char*) "SBR C2U AAAAAD//////////8AAAAAAAAAAAAAAAAAAAAAAAAAAAAAAAAA",
// (char*) "SBR C2+ AAAAAD//////////wAAAAAAAAAAAAAAAAAAAAAAAAAAAAAAAAA",
// (char*) "SBR C3o AAAAAB//////////AAAAAAAAAAAAAAAAAAAAAAAAAAAAAAAAAA",
// (char*) "SBR C4T AAAAAB/////////8AAAAAAAAAAAAAAAAAAAAAAAAAAAAAAAAAA",
// (char*) "SBR C49 AAAAAB/////////wAAAAAAAAAAAAAAAAAAAAAAAAAAAAAAAAAA",
// (char*) "SBR C5n AAAAAA/////////wAAAAAAAAAAAAAAAAAAAAAAAAAAAAAAAAAA",
// (char*) "SBR C6S AAAAAA/////////4AAAAAAAAAAAAAAAAAAAAAAAAAAAAAAAAAA",
// (char*) "SBR C7m AAAAAAf////////4AAAAAAAAAAAAAAAAAAAAAAAAAAAAAAAAAA",
// (char*) "SBR C87 AAAAAAP////////4AAAAAAAAAAAAAAAAAAAAAAAAAAAAAAAAAA",
// (char*) "SBR C9l AAAAAAH////////8AAAAAAAAAAAAAAAAAAAAAAAAAAAAAAAAAA",
// (char*) "SBR C+6 AAAAAAD////////8AAAAAAAAAAAAAAAAAAAAAAAAAAAAAAAAAA",
// (char*) "SBR DAP AAAAAAB////////wAAAAAAAAAAAAAAAAAAAAAAAAAAAAAAAAAA",
// (char*) "SBR DA5 AAAAAAB////////gAAAAAAAAAAAAAAAAAAAAAAAAAAAAAAAAAA",
// (char*) "SBR DBj AAAAAAA////////AAAAAAAAAAAAAAAAAAAAAAAAAAAAAAAAAAA",
// (char*) "SBR DCO AAAAAAA///////+AAAAAAAAAAAAAAAAAAAAAAAAAAAAAAAAAAA",
// (char*) "SBR DC4 AAAAAAAf//////4AAAAAAAAAAAAAAAAAAAAAAAAAAAAAAAAAAA",
// (char*) "SBR DDi AAAAAAAf//////gAAAAAAAAAAAAAAAAAAAAAAAAAAAAAAAAAAA",
// (char*) "SBR DEN AAAAAAAP//////AAAAAAAAAAAAAAAAAAAAAAAAAAAAAAAAAAAA",
// (char*) "SBR DE3 AAAAAAAP/////8AAAAAAAAAAAAAAAAAAAAAAAAAAAAAAAAAAAA",
// (char*) "SBR DFh AAAAAAAH/////4AAAAAAAAAAAAAAAAAAAAAAAAAAAAAAAAAAAA",
// (char*) "SBR DGM AAAAAAAD/////gAAAAAAAAAAAAAAAAAAAAAAAAAAAAAAAAAAAA",
// (char*) "SBR DG2 AAAAAAAD////+AAAAAAAAAAAAAAAAAAAAAAAAAAAAAAAAAAAAA",
// (char*) "SBR DHg AAAAAAAB////4AAAAAAAAAAAAAAAAAAAAAAAAAAAAAAAAAAAAA",
// (char*) "SBR DIL AAAAAAAA////gAAAAAAAAAAAAAAAAAAAAAAAAAAAAAAAAAAAAA",
// (char*) "SBR DI1 AAAAAAAAf//+AAAAAAAAAAAAAAAAAAAAAAAAAAAAAAAAAAAAAA",
// (char*) "SBR DJf AAAAAAAAf//wAAAAAAAAAAAAAAAAAAAAAAAAAAAAAAAAAAAAAA",
// (char*) "SBR DKK AAAAAAAAP/+AAAAAAAAAAAAAAAAAAAAAAAAAAAAAAAAAAAAAAA",
// (char*) "SBR DK0 AAAAAAAAH/4AAAAAAAAAAAAAAAAAAAAAAAAAAAAAAAAAAAAAAA",
// (char*) "SBR DLe AAAAAAAAD/AAAAAAAAAAAAAAAAAAAAAAAAAAAAAAAAAAAAAAAA",
// (char*) "SBR DMJ AAAAAAAADwAAAAAAAAAAAAAAAAAAAAAAAAAAAAAAAAAAAAAAAA",
// (char*) "SBR DMz AAAAAAAAAAAAAAAAAAAAAAAAAAAAAAAAAAAAAAAAAAAAAAAAAA",
// (char*) "SBR DWE AAAAAAAAAAAAAAAAAAAAAAAAAAAAAAAAAAAAAAAAAAAAAAAAAA"

// (char*) "SBR uN AAAAAAAAAAAAAAAAAAAAAAAAAAAAAAAAAAAAAAAAAAAAAAAAAA\n",      // 129 LINES Nike Swoosh
// (char*) "SBR BKq AAAAAAAAAAAAAAAAAAAAAAAAAAB//wAAAAAAAAAAAAAAAAAAAA\n",
// (char*) "SBR BLU AAAAAAAAAAAAAAAAAAAAAAAAAAP//8AAAAAAAAAAAAAAAAAAAA\n",
// (char*) "SBR BL+ AAAAAAAAAAAAAAAAAAAAAAAAAA////AAAAAAAAAAAAAAAAAAAA\n",
// (char*) "SBR BMp AAAAAAAAAAAAAAAAAAAAAAAAAD////gAAAAAAAAAAAAAAAAAAA\n",
// (char*) "SBR BNT AAAAAAAAAAAAAAAAAAAAAAAAA/////8AAAAAAAAAAAAAAAAAAA\n",
// (char*) "SBR BN9 AAAAAAAAAAAAAAAAAAAAAAAAD/////8AAAAAAAAAAAAAAAAAAA\n",
// (char*) "SBR BOo AAAAAAAAAAAAAAAAAAAAAAAAH/////+AAAAAAAAAAAAAAAAAAA\n",
// (char*) "SBR BPS AAAAAAAAAAAAAAAAAAAAAAAAf//////AAAAAAAAAAAAAAAAAAA\n",
// (char*) "SBR BP8 AAAAAAAAAAAAAAAAAAAAAAAB///////gAAAAAAAAAAAAAAAAAA\n",
// (char*) "SBR BQn AAAAAAAAAAAAAAAAAAAAAAAD///////wAAAAAAAAAAAAAAAAAA\n",
// (char*) "SBR BRR AAAAAAAAAAAAAAAAAAAAAAAP///////wAAAAAAAAAAAAAAAAAA\n",
// (char*) "SBR BR7 AAAAAAAAAAAAAAAAAAAAAAAf///////wAAAAAAAAAAAAAAAAAA\n",
// (char*) "SBR BSm AAAAAAAAAAAAAAAAAAAAAAD////////4AAAAAAAAAAAAAAAAAA\n",
// (char*) "SBR BT6 AAAAAAAAAAAAAAAAAAAAAAP////////8AAAAAAAAAAAAAAAAAA\n",
// (char*) "SBR BUl AAAAAAAAAAAAAAAAAAAAAAf////////8AAAAAAAAAAAAAAAAAA\n",
// (char*) "SBR BVP AAAAAAAAAAAAAAAAAAAAAA/////////8AAAAAAAAAAAAAAAAAA\n",
// (char*) "SBR BV5 AAAAAAAAAAAAAAAAAAAAAD/////////8AAAAAAAAAAAAAAAAAA\n",
// (char*) "SBR BWk AAAAAAAAAAAAAAAAAAAAAH/////////+AAAAAAAAAAAAAAAAAA\n",
// (char*) "SBR BXO AAAAAAAAAAAAAAAAAAAAAP/////////+AAAAAAAAAAAAAAAAAA\n",
// (char*) "SBR BX4 AAAAAAAAAAAAAAAAAAAAA//////////+AAAAAAAAAAAAAAAAAA\n",
// (char*) "SBR BYj AAAAAAAAAAAAAAAAAAAAB//////////+AAAAAAAAAAAAAAAAAA\n",
// (char*) "SBR BZN AAAAAAAAAAAAAAAAAAAAD//////////+AAAAAAAAAAAAAAAAAA\n",
// (char*) "SBR BZ3 AAAAAAAAAAAAAAAAAAAAD/4AP//////+AAAAAAAAAAAAAAAAAA\n",
// (char*) "SBR Bai AAAAAAAAAAAAAAAAAAAAf4AAA//////+AAAAAAAAAAAAAAAAAA\n",
// (char*) "SBR BbM AAAAAAAAAAAAAAAAAAAA/gAAAP/////+AAAAAAAAAAAAAAAAAA\n",
// (char*) "SBR Bb2 AAAAAAAAAAAAAAAAAAAA8AAAAP/////+AAAAAAAAAAAAAAAAAA\n",
// (char*) "SBR Bch AAAAAAAAAAAAAAAAAAAB4AAAAH/////+AAAAAAAAAAAAAAAAAA\n",
// (char*) "SBR BdL AAAAAAAAAAAAAAAAAAAHAAAAAB/////+AAAAAAAAAAAAAAAAAA\n",
// (char*) "SBR Bd1 AAAAAAAAAAAAAAAAAAAMAAAAAA/////+AAAAAAAAAAAAAAAAAA\n",
// (char*) "SBR Beg AAAAAAAAAAAAAAAAAAAAAAAAAA/////+AAAAAAAAAAAAAAAAAA\n",
// (char*) "SBR Bf0 AAAAAAAAAAAAAAAAAAAAAAAAAAf////+AAAAAAAAAAAAAAAAAA\n",
// (char*) "SBR Bgf AAAAAAAAAAAAAAAAAAAAAAAAAAf////8AAAAAAAAAAAAAAAAAA\n",
// (char*) "SBR BhJ AAAAAAAAAAAAAAAAAAAAAAAAAAP////8AAAAAAAAAAAAAAAAAA\n",
// (char*) "SBR Bie AAAAAAAAAAAAAAAAAAAAAAAAAAH////8AAAAAAAAAAAAAAAAAA\n",
// (char*) "SBR Bjy AAAAAAAAAAAAAAAAAAAAAAAAAAH////4AAAAAAAAAAAAAAAAAA\n",
// (char*) "SBR BlH AAAAAAAAAAAAAAAAAAAAAAAAAAD////wAAAAAAAAAAAAAAAAAA\n",
// (char*) "SBR BpF AAAAAAAAAAAAAAAAAAAAAAAAAAD////gAAAAAAAAAAAAAAAAAA\n",
// (char*) "SBR Bqa AAAAAAAAAAAAAAAAAAAAAAAAAAH////AAAAAAAAAAAAAAAAAAA\n",
// (char*) "SBR BsZ AAAAAAAAAAAAAAAAAAAAAAAAAAH///+AAAAAAAAAAAAAAAAAAA\n",
// (char*) "SBR Btt AAAAAAAAAAAAAAAAAAAAAAAAAAP///8AAAAAAAAAAAAAAAAAAA\n",
// (char*) "SBR BwX AAAAAAAAAAAAAAAAAAAAAAAAAAf///4AAAAAAAAAAAAAAAAAAA\n",
// (char*) "SBR Bxr AAAAAAAAAAAAAAAAAAAAAAAAAAf///wAAAAAAAAAAAAAAAAAAA\n",
// (char*) "SBR ByW AAAAAAAAAAAAAAAAAAAAAAAAAA////gAAAAAAAAAAAAAAAAAAA\n",
// (char*) "SBR Bzq AAAAAAAAAAAAAAAAAAAAAAAAAA////AAAAAAAAAAAAAAAAAAAA\n",
// (char*) "SBR B2U AAAAAAAAAAAAAAAAAAAAAAAAAB///+AAAAAAAAAAAAAAAAAAAA\n",
// (char*) "SBR B3o AAAAAAAAAAAAAAAAAAAAAAAAAD///8AAAAAAAAAAAAAAAAAAAA\n",
// (char*) "SBR B4T AAAAAAAAAAAAAAAAAAAAAAAAAD///4AAAAAAAAAAAAAAAAAAAA\n",
// (char*) "SBR B6S AAAAAAAAAAAAAAAAAAAAAAAAAH///wAAAAAAAAAAAAAAAAAAAA\n",
// (char*) "SBR B8R AAAAAAAAAAAAAAAAAAAAAAAAAP///gAAAAAAAAAAAAAAAAAAAA\n",
// (char*) "SBR B87 AAAAAAAAAAAAAAAAAAAAAAAAAP///AAAAAAAAAAAAAAAAAAAAA\n",
// (char*) "SBR B+6 AAAAAAAAAAAAAAAAAAAAAAAAAP//+AAAAAAAAAAAAAAAAAAAAA\n",
// (char*) "SBR B/k AAAAAAAAAAAAAAAAAAAAAAAAAf//8AAAAAAAAAAAAAAAAAAAAA\n",
// (char*) "SBR CCO AAAAAAAAAAAAAAAAAAAAAAAAA///4AAAAAAAAAAAAAAAAAAAAA\n",
// (char*) "SBR CDi AAAAAAAAAAAAAAAAAAAAAAAAB///wAAAAAAAAAAAAAAAAAAAAA\n",
// (char*) "SBR CE3 AAAAAAAAAAAAAAAAAAAAAAAAB///gAAAAAAAAAAAAAAAAAAAAA\n",
// (char*) "SBR CFh AAAAAAAAAAAAAAAAAAAAAAAAD///AAAAAAAAAAAAAAAAAAAAAA\n",
// (char*) "SBR CIL AAAAAAAAAAAAAAAAAAAAAAAAD//+AAAAAAAAAAAAAAAAAAAAAA\n",
// (char*) "SBR CJf AAAAAAAAAAAAAAAAAAAAAAAAH//8AAAAAAAAAAAAAAAAAAAAAA\n",
// (char*) "SBR CKK AAAAAAAAAAAAAAAAAAAAAAAAH//4AAAAAAAAAAAAAAAAAAAAAA\n",
// (char*) "SBR CLe AAAAAAAAAAAAAAAAAAAAAAAAP//4AAAAAAAAAAAAAAAAAAAAAA\n",
// (char*) "SBR CMJ AAAAAAAAAAAAAAAAAAAAAAAAP//wAAAAAAAAAAAAAAAAAAAAAA\n",
// (char*) "SBR CNd AAAAAAAAAAAAAAAAAAAAAAAAf//wAAAAAAAAAAAAAAAAAAAAAA\n",
// (char*) "SBR COI AAAAAAAAAAAAAAAAAAAAAAAAf//gAAAAAAAAAAAAAAAAAAAAAA\n",
// (char*) "SBR CPc AAAAAAAAAAAAAAAAAAAAAAAA///AAAAAAAAAAAAAAAAAAAAAAA\n",
// (char*) "SBR CQx AAAAAAAAAAAAAAAAAAAAAAAA//+AAAAAAAAAAAAAAAAAAAAAAA\n",
// (char*) "SBR CSG AAAAAAAAAAAAAAAAAAAAAAAA//8AAAAAAAAAAAAAAAAAAAAAAA\n",
// (char*) "SBR CTa AAAAAAAAAAAAAAAAAAAAAAAB//8AAAAAAAAAAAAAAAAAAAAAAA\n",
// (char*) "SBR CUF AAAAAAAAAAAAAAAAAAAAAAAB//4AAAAAAAAAAAAAAAAAAAAAAA\n",
// (char*) "SBR CUv AAAAAAAAAAAAAAAAAAAAAAAD//wAAAAAAAAAAAAAAAAAAAAAAA\n",
// (char*) "SBR CWu AAAAAAAAAAAAAAAAAAAAAAAD//gAAAAAAAAAAAAAAAAAAAAAAA\n",
// (char*) "SBR CXY AAAAAAAAAAAAAAAAAAAAAAAH//AAAAAAAAAAAAAAAAAAAAAAAA\n",
// (char*) "SBR CZX AAAAAAAAAAAAAAAAAAAAAAAP//AAAAAAAAAAAAAAAAAAAAAAAA\n",
// (char*) "SBR CaC AAAAAAAAAAAAAAAAAAAAAAAP/+AAAAAAAAAAAAAAAAAAAAAAAA\n",
// (char*) "SBR CbW AAAAAAAAAAAAAAAAAAAAAAAP/8AAAAAAAAAAAAAAAAAAAAAAAA\n",
// (char*) "SBR Ccr AAAAAAAAAAAAAAAAAAAAAAAf/4AAAAAAAAAAAAAAAAAAAAAAAA\n",
// (char*) "SBR CdV AAAAAAAAAAAAAAAAAAAAAAAf/wAAAAAAAAAAAAAAAAAAAAAAAA\n",
// (char*) "SBR Ceq AAAAAAAAAAAAAAAAAAAAAAA//wAAAAAAAAAAAAAAAAAAAAAAAA\n",
// (char*) "SBR Cf/ AAAAAAAAAAAAAAAAAAAAAAA//gAAAAAAAAAAAAAAAAAAAAAAAA\n",
// (char*) "SBR Cgp AAAAAAAAAAAAAAAAAAAAAAB//gAAAAAAAAAAAAAAAAAAAAAAAA\n",
// (char*) "SBR ChT AAAAAAAAAAAAAAAAAAAAAAB//AAAAAAAAAAAAAAAAAAAAAAAAA\n",
// (char*) "SBR Ch+ AAAAAAAAAAAAAAAAAAAAAAB/+AAAAAAAAAAAAAAAAAAAAAAAAA\n",
// (char*) "SBR Cio AAAAAAAAAAAAAAAAAAAAAAD/+AAAAAAAAAAAAAAAAAAAAAAAAA\n",
// (char*) "SBR Cj9 AAAAAAAAAAAAAAAAAAAAAAD/8AAAAAAAAAAAAAAAAAAAAAAAAA\n",
// (char*) "SBR Cl8 AAAAAAAAAAAAAAAAAAAAAAD/4AAAAAAAAAAAAAAAAAAAAAAAAA\n",
// (char*) "SBR Cmm AAAAAAAAAAAAAAAAAAAAAAH/4AAAAAAAAAAAAAAAAAAAAAAAAA\n",
// (char*) "SBR CnQ AAAAAAAAAAAAAAAAAAAAAAH/wAAAAAAAAAAAAAAAAAAAAAAAAA\n",
// (char*) "SBR Col AAAAAAAAAAAAAAAAAAAAAAP/gAAAAAAAAAAAAAAAAAAAAAAAAA\n",
// (char*) "SBR Cp6 AAAAAAAAAAAAAAAAAAAAAAP/AAAAAAAAAAAAAAAAAAAAAAAAAA\n",
// (char*) "SBR Cqk AAAAAAAAAAAAAAAAAAAAAAf/AAAAAAAAAAAAAAAAAAAAAAAAAA\n",
// (char*) "SBR Csj AAAAAAAAAAAAAAAAAAAAAA/+AAAAAAAAAAAAAAAAAAAAAAAAAA\n",
// (char*) "SBR CtN AAAAAAAAAAAAAAAAAAAAAA/8AAAAAAAAAAAAAAAAAAAAAAAAAA\n",
// (char*) "SBR Cui AAAAAAAAAAAAAAAAAAAAAA/4AAAAAAAAAAAAAAAAAAAAAAAAAA\n",
// (char*) "SBR CvM AAAAAAAAAAAAAAAAAAAAAA/wAAAAAAAAAAAAAAAAAAAAAAAAAA\n",
// (char*) "SBR Cv3 AAAAAAAAAAAAAAAAAAAAAB/wAAAAAAAAAAAAAAAAAAAAAAAAAA\n",
// (char*) "SBR Cx2 AAAAAAAAAAAAAAAAAAAAAD/gAAAAAAAAAAAAAAAAAAAAAAAAAA\n",
// (char*) "SBR CzK AAAAAAAAAAAAAAAAAAAAAD/AAAAAAAAAAAAAAAAAAAAAAAAAAA\n",
// (char*) "SBR C0f AAAAAAAAAAAAAAAAAAAAAH+AAAAAAAAAAAAAAAAAAAAAAAAAAA\n",
// (char*) "SBR C1J AAAAAAAAAAAAAAAAAAAAAH8AAAAAAAAAAAAAAAAAAAAAAAAAAA\n",
// (char*) "SBR C10 AAAAAAAAAAAAAAAAAAAAAP8AAAAAAAAAAAAAAAAAAAAAAAAAAA\n",
// (char*) "SBR C3z AAAAAAAAAAAAAAAAAAAAAP4AAAAAAAAAAAAAAAAAAAAAAAAAAA\n",
// (char*) "SBR C5H AAAAAAAAAAAAAAAAAAAAAPwAAAAAAAAAAAAAAAAAAAAAAAAAAA\n",
// (char*) "SBR C5y AAAAAAAAAAAAAAAAAAAAAfwAAAAAAAAAAAAAAAAAAAAAAAAAAA\n",
// (char*) "SBR C6c AAAAAAAAAAAAAAAAAAAAAfgAAAAAAAAAAAAAAAAAAAAAAAAAAA\n",
// (char*) "SBR C7x AAAAAAAAAAAAAAAAAAAAAfAAAAAAAAAAAAAAAAAAAAAAAAAAAA\n",
// (char*) "SBR C8b AAAAAAAAAAAAAAAAAAAAA/AAAAAAAAAAAAAAAAAAAAAAAAAAAA\n",
// (char*) "SBR C9w AAAAAAAAAAAAAAAAAAAAB+AAAAAAAAAAAAAAAAAAAAAAAAAAAA\n",
// (char*) "SBR C/E AAAAAAAAAAAAAAAAAAAAB8AAAAAAAAAAAAAAAAAAAAAAAAAAAA\n",
// (char*) "SBR C/v AAAAAAAAAAAAAAAAAAAAD8AAAAAAAAAAAAAAAAAAAAAAAAAAAA\n",
// (char*) "SBR DAZ AAAAAAAAAAAAAAAAAAAAD4AAAAAAAAAAAAAAAAAAAAAAAAAAAA\n",
// (char*) "SBR DBu AAAAAAAAAAAAAAAAAAAADwAAAAAAAAAAAAAAAAAAAAAAAAAAAA\n",
// (char*) "SBR DDt AAAAAAAAAAAAAAAAAAAAHwAAAAAAAAAAAAAAAAAAAAAAAAAAAA\n",
// (char*) "SBR DEX AAAAAAAAAAAAAAAAAAAAHgAAAAAAAAAAAAAAAAAAAAAAAAAAAA\n",
// (char*) "SBR DFB AAAAAAAAAAAAAAAAAAAAPAAAAAAAAAAAAAAAAAAAAAAAAAAAAA\n",
// (char*) "SBR DGW AAAAAAAAAAAAAAAAAAAAOAAAAAAAAAAAAAAAAAAAAAAAAAAAAA\n",
// (char*) "SBR DHA AAAAAAAAAAAAAAAAAAAAeAAAAAAAAAAAAAAAAAAAAAAAAAAAAA\n",
// (char*) "SBR DHr AAAAAAAAAAAAAAAAAAAAcAAAAAAAAAAAAAAAAAAAAAAAAAAAAA\n",
// (char*) "SBR DJq AAAAAAAAAAAAAAAAAAAA4AAAAAAAAAAAAAAAAAAAAAAAAAAAAA\n",
// (char*) "SBR DK+ AAAAAAAAAAAAAAAAAAAAwAAAAAAAAAAAAAAAAAAAAAAAAAAAAA\n",
// (char*) "SBR DMT AAAAAAAAAAAAAAAAAAAAgAAAAAAAAAAAAAAAAAAAAAAAAAAAAA\n",
// (char*) "SBR DNo AAAAAAAAAAAAAAAAAAABAAAAAAAAAAAAAAAAAAAAAAAAAAAAAA\n",
// (char*) "SBR DO8 AAAAAAAAAAAAAAAAAAADAAAAAAAAAAAAAAAAAAAAAAAAAAAAAA\n",
// (char*) "SBR DPn AAAAAAAAAAAAAAAAAAACAAAAAAAAAAAAAAAAAAAAAAAAAAAAAA\n",
// (char*) "SBR DQ7 AAAAAAAAAAAAAAAAAAAAAAAAAAAAAAAAAAAAAAAAAAAAAAAAAA\n",
// (char*) "SBR DRm AAAAAAAAAAAAAAAAAAAEAAAAAAAAAAAAAAAAAAAAAAAAAAAAAA\n",
// (char*) "SBR DSQ AAAAAAAAAAAAAAAAAAAAAAAAAAAAAAAAAAAAAAAAAAAAAAAAAA\n",
// (char*) "SBR DS6 AAAAAAAAAAAAAAAAAAAIAAAAAAAAAAAAAAAAAAAAAAAAAAAAAA\n",
// (char*) "SBR DTl AAAAAAAAAAAAAAAAAAAAAAAAAAAAAAAAAAAAAAAAAAAAAAAAAA\n",
// (char*) "SBR D1U AAAAAAAAAAAAAAAAAAAAAAAAAAAAAAAAAAAAAAAAAAAAAAAAAA\n"


// (char*)  "SBR O9 AAAAAAAAAAAAAAAAAAAAAAAAAAAAAAAAAAAAAAAAAAAAAAAAAA\n",   // eigth note, 128 lines
// (char*)  "SBR BF3 AAAAAAAAAAAAAAAAAAAAAAAAAAAAAAAAAAAAAAAAAAnkAAAAAA\n",
// (char*)  "SBR BGh AAAAAAAAAAAAAAAAAAAAAAAAAAAAAAAAAAAAAAAAAD//gAAAAA\n",
// (char*)  "SBR BHM AAAAAAAAAAAAAAAAAAAAAAAAAAAAAAAAAAAAAAAAA///wAAAAA\n",
// (char*)  "SBR BH2 AAAAAAAAAAAAAAAAAAAAAAAAAAAAAAAAAAAAAAAAD///+AAAAA\n",
// (char*)  "SBR BIg AAAAAAAAAAAAAAAAAAAAAAAAAAAAAAAAAAAAAAAAP////AAAAA\n",
// (char*)  "SBR BJL AAAAAAAAAAAAAAAAAAAAAAAAAAAAAAAAAAAAAAAAf////gAAAA\n",
// (char*)  "SBR BJ1 AAAAAAAAAAAAAAAAAAAAAAAAAAAAAAAAAAAAAAAB/////4AAAA\n",
// (char*)  "SBR BKf AAAAAAAAAAAAAAAAAAAAAAAAAAAAAAAAAAAAAAAB/////8AAAA\n",
// (char*)  "SBR BLK AAAAAAAAAAAAAAAAAAAAAAAAAAAAAAAAAAAAAAAH/////8AAAA\n",
// (char*)  "SBR BL0 AAAAAAAAAAAAAAAAAAAAAAAAAAAAAAAAAAAAAAAP/////+AAAA\n",
// (char*)  "SBR BMe AAAAAAAAAAAAAAAAAAAAAAAAAAAAAAAAAAAAAAAf//////AAAA\n",
// (char*)  "SBR BNJ AAAAAAAAAAAAAAAAAAAAAAAAAAAAAAAAAAAAAAA///////gAAA\n",
// (char*)  "SBR BNz AAAAAAAAAAAAAAAAAAAAAAAAAAAAAAAAAAAAAAB///////gAAA\n",
// (char*)  "SBR BOd AAAAAAAAAAAAAAAAAAAAAAAAAAAAAAAAAAAAAAD///////gAAA\n",
// (char*)  "SBR BPI AAAAAAAAAAAAAAAAAAAAAAAAAAAAAAAAAAAAAAH///////wAAA\n",
// (char*)  "SBR BPy AAAAAAAAAAAAAAAAAAAAAAAAAAAAAAAAAAAAAAH///////4AAA\n",
// (char*)  "SBR BQc AAAAAAAAAAAAAAAAAAAAAAAAAAAAAAAAAAAAAAf///////wAAA\n",
// (char*)  "SBR BRH AAAAAAAAAAAAAAAAAAAAAAAAAAAAAAAAAAAAAAf///////4AAA\n",
// (char*)  "SBR BRx AAAAAAAAAAAAAAAAAAAAAAAAAAAAAAAAAAAAAA////////4AAA\n",
// (char*)  "SBR BSb AAAAAAAAAAAAAAAAAAAAAAAAAAAAAAAAAAAAAA////////8AAA\n",
// (char*)  "SBR BTG AAAAAAAAAAAAAAAAAAAAAAAAAAAAAAAAAAAAAB////////4AAA\n",
// (char*)  "SBR BTw AAAAAAAAAAAAAAAAAAAAAAAAAAAAAAAAAAAAAD////////8AAA\n",
// (char*)  "SBR BVF AAAAAAAAAAAAAAAAAAAAAAAAAAAAAAAAAAAAAH////////8AAA\n",
// (char*)  "SBR BVv AAAAAAAAAAAAAAAAAAAAAAAAAAAAAAAAAAAAAP////////8AAA\n",
// (char*)  "SBR BWZ AAAAAAAAAAAAAAAAAAAAAAAAAAAAAAAAAAAAAf////////8AAA\n",
// (char*)  "SBR BXu AAAAAAAAAAAAAAAAAAAAAAAAAAAAAAAAAAAAA/////////8AAA\n",
// (char*)  "SBR BZD AAAAAAAAAAAAAAAAAAAAAAAAAAAAAAAAAAAAB/////////8AAA\n",
// (char*)  "SBR BaX AAAAAAAAAAAAAAAAAAAAAAAAAAAAAAAAAAAAB/////////4AAA\n",
// (char*)  "SBR BbC AAAAAAAAAAAAAAAAAAAAAAAAAAAAAAAAAAAAD/////////8AAA\n",
// (char*)  "SBR Bbs AAAAAAAAAAAAAAAAAAAAAAAAAAAAAAAAAAAAD/////////4AAA\n",
// (char*)  "SBR BdB AAAAAAAAAAAAAAAAAAAAAAAAAAAAAAAAAAAAH/////////4AAA\n",
// (char*)  "SBR Bdr AAAAAAAAAAAAAAAAAAAAAAAAAAAAAAAAAAAAH/////////wAAA\n",
// (char*)  "SBR BeV AAAAAAAAAAAAAAAAAAAAAAAAAAAAAAAAAAAAH/////////4AAA\n",
// (char*)  "SBR BfA AAAAAAAAAAAAAAAAAAAAAAAAAAAAAAAAAAAAP/////////wAAA\n",
// (char*)  "SBR BgU AAAAAAAAAAAAAAAAAAAAAAAAAAAAAAAAAAAAf/////////gAAA\n",
// (char*)  "SBR Bg/ AAAAAAAAAAAAAAAAAAAAAAAAAAAAAAAAAAAAP/////////gAAA\n",
// (char*)  "SBR Bhp AAAAAAAAAAAAAAAAAAAAAAAAAAAAAAAAAAAAf/////////gAAA\n",
// (char*)  "SBR BiT AAAAAAAAAAAAAAAAAAAAAAAAAAAAAAAAAAAAf/////////AAAA\n",
// (char*)  "SBR BkS AAAAAAAAAAAAAAAAAAAAAAAAAAAAAAAAAAAAf////////+AAAA\n",
// (char*)  "SBR Bk9 AAAAAAAAAAAAAAAAAAAAAAAAAAAAAAAAAAAA/////////+AAAA\n",
// (char*)  "SBR BmR AAAAAAAAAAAAAAAAAAAAAAAAAAAAAAAAAAAA/////////8AAAA\n",
// (char*)  "SBR Bnm AAAAAAAAAAAAAAAAAAAAAAAAAAAAAAAAAAAA/////////4AAAA\n",
// (char*)  "SBR BoQ AAAAAAAAAAAAAAAAAAAAAAAAAAAAAAAAAAAA/////////wAAAA\n",
// (char*)  "SBR Bo7 AAAAAAAAAAAAAAAAAAAAAAAAAAAAAAAAAAAA/////////gAAAA\n",
// (char*)  "SBR Bq6 AAAAAAAAAAAAAAAAAAAAAAAAAAAAAAAAAAAAf////////AAAAA\n",
// (char*)  "SBR Brk AAAAAAAAAAAAAAAAAAAAAAAAAAAAAAAAAAAAf///////+AAAAA\n",
// (char*)  "SBR BsO AAAAAAAAAAAAAAAAAAAAAAAAAAAAAAAAAAAAf///////8AAAAA\n",
// (char*)  "SBR Bs5 AAAAAAAAAAAAAAAAAAAAAAAAAAAAAAAAAAAAf///////4AAAAA\n",
// (char*)  "SBR BuN AAAAAAAAAAAAAAAAAAAAAAAAAAAAAAAAAAAAP///////wAAAAA\n",
// (char*)  "SBR Bu4 AAAAAAAAAAAAAAAAAAAAAAAAAAAAAAAAAAAAP///////gAAAAA\n",
// (char*)  "SBR Bvi AAAAAAAAAAAAAAAAAAAAAAAAAAAAAAAAAAAAH///////AAAAAA\n",
// (char*)  "SBR BwM AAAAAAAAAAAAAAAAAAAAAAAAAAAAAAAAAAAAH//////+AAAAAA\n",
// (char*)  "SBR Bw3 AAAAAAAAAAAAAAAAAAAAAAAAAAAAAAAAAAAAH//////8AAAAAA\n",
// (char*)  "SBR Bxh AAAAAAAAAAAAAAAAAAAAAAAAAAAAAAAAAAAAH//////4AAAAAA\n",
// (char*)  "SBR ByL AAAAAAAAAAAAAAAAAAAAAAAAAAAAAAAAAAAAD//////wAAAAAA\n",
// (char*)  "SBR By2 AAAAAAAAAAAAAAAAAAAAAAAAAAAAAAAAAAAAB//////gAAAAAA\n",
// (char*)  "SBR Bzg AAAA//////////////////////////////////////+AAAAAAA\n",
// (char*)  "SBR B0K AAAA//////////////////////////////////////8AAAAAAA\n",
// (char*)  "SBR B01 AAAA//////////////////////////////////////4AAAAAAA\n",
// (char*)  "SBR B1f AAAA//////////////////////////////////////AAAAAAAA\n",
// (char*)  "SBR B2J AAAA/////////////////////////////////////+AAAAAAAA\n",
// (char*)  "SBR B20 AAAA/////////////////////////////////////wAAAAAAAA\n",
// (char*)  "SBR B3e AAAA/////////////////////////////////////gAAAAAAAA\n",
// (char*)  "SBR B4I AAAA////////////////////////////////////6AAAAAAAAA\n",
// (char*)  "SBR B4z AAAA////////////////////////////////////AAAAAAAAAA\n",
// (char*)  "SBR B5d AAAAAAn////////+AAAAAAAAAAAAAAAAAAAAAAAAAAAAAAAAAA\n",
// (char*)  "SBR B6H AAAAAAAv///////+AAAAAAAAAAAAAAAAAAAAAAAAAAAAAAAAAA\n",
// (char*)  "SBR B6y AAAAAAAA///////8AAAAAAAAAAAAAAAAAAAAAAAAAAAAAAAAAA\n",
// (char*)  "SBR B7c AAAAAAAAP//////+AAAAAAAAAAAAAAAAAAAAAAAAAAAAAAAAAA\n",
// (char*)  "SBR B8G AAAAAAAAA//////+AAAAAAAAAAAAAAAAAAAAAAAAAAAAAAAAAA\n",
// (char*)  "SBR B8x AAAAAAAAAf//////AAAAAAAAAAAAAAAAAAAAAAAAAAAAAAAAAA\n",
// (char*)  "SBR B9b AAAAAAAAAH//////AAAAAAAAAAAAAAAAAAAAAAAAAAAAAAAAAA\n",
// (char*)  "SBR B+F AAAAAAAAAB//////AAAAAAAAAAAAAAAAAAAAAAAAAAAAAAAAAA\n",
// (char*)  "SBR B+w AAAAAAAAAAf/////AAAAAAAAAAAAAAAAAAAAAAAAAAAAAAAAAA\n",
// (char*)  "SBR B/a AAAAAAAAAAP/////gAAAAAAAAAAAAAAAAAAAAAAAAAAAAAAAAA\n",
// (char*)  "SBR CAE AAAAAAAAAAD/////wAAAAAAAAAAAAAAAAAAAAAAAAAAAAAAAAA\n",
// (char*)  "SBR CAv AAAAAAAAAAB/////wAAAAAAAAAAAAAAAAAAAAAAAAAAAAAAAAA\n",
// (char*)  "SBR CBZ AAAAAAAAAAAf////wAAAAAAAAAAAAAAAAAAAAAAAAAAAAAAAAA\n",
// (char*)  "SBR CCD AAAAAAAAAAAH////wAAAAAAAAAAAAAAAAAAAAAAAAAAAAAAAAA\n",
// (char*)  "SBR CCu AAAAAAAAAAAH////4AAAAAAAAAAAAAAAAAAAAAAAAAAAAAAAAA\n",
// (char*)  "SBR CDY AAAAAAAAAAAB////4AAAAAAAAAAAAAAAAAAAAAAAAAAAAAAAAA\n",
// (char*)  "SBR CEC AAAAAAAAAAAA////8AAAAAAAAAAAAAAAAAAAAAAAAAAAAAAAAA\n",
// (char*)  "SBR CEt AAAAAAAAAAAAf///8AAAAAAAAAAAAAAAAAAAAAAAAAAAAAAAAA\n",
// (char*)  "SBR CFX AAAAAAAAAAAAH///+AAAAAAAAAAAAAAAAAAAAAAAAAAAAAAAAA\n",
// (char*)  "SBR CGB AAAAAAAAAAAAH////AAAAAAAAAAAAAAAAAAAAAAAAAAAAAAAAA\n",
// (char*)  "SBR CGs AAAAAAAAAAAAD////AAAAAAAAAAAAAAAAAAAAAAAAAAAAAAAAA\n",
// (char*)  "SBR CHW AAAAAAAAAAAAA////gAAAAAAAAAAAAAAAAAAAAAAAAAAAAAAAA\n",
// (char*)  "SBR CIA AAAAAAAAAAAAAf///wAAAAAAAAAAAAAAAAAAAAAAAAAAAAAAAA\n",
// (char*)  "SBR CIr AAAAAAAAAAAAAP///wAAAAAAAAAAAAAAAAAAAAAAAAAAAAAAAA\n",
// (char*)  "SBR CJV AAAAAAAAAAAAAD///wAAAAAAAAAAAAAAAAAAAAAAAAAAAAAAAA\n",
// (char*)  "SBR CJ/ AAAAAAAAAAAAAB///4AAAAAAAAAAAAAAAAAAAAAAAAAAAAAAAA\n",
// (char*)  "SBR CKq AAAAAAAAAAAAAB///8AAAAAAAAAAAAAAAAAAAAAAAAAAAAAAAA\n",
// (char*)  "SBR CLU AAAAAAAAAAAAAA///8AAAAAAAAAAAAAAAAAAAAAAAAAAAAAAAA\n",
// (char*)  "SBR CL+ AAAAAAAAAAAAAAP///AAAAAAAAAAAAAAAAAAAAAAAAAAAAAAAA\n",
// (char*)  "SBR CMp AAAAAAAAAAAAAAH///AAAAAAAAAAAAAAAAAAAAAAAAAAAAAAAA\n",
// (char*)  "SBR CNT AAAAAAAAAAAAAAD///gAAAAAAAAAAAAAAAAAAAAAAAAAAAAAAA\n",
// (char*)  "SBR CN9 AAAAAAAAAAAAAAB///gAAAAAAAAAAAAAAAAAAAAAAAAAAAAAAA\n",
// (char*)  "SBR COo AAAAAAAAAAAAAAAf//4AAAAAAAAAAAAAAAAAAAAAAAAAAAAAAA\n",
// (char*)  "SBR CPS AAAAAAAAAAAAAAAf//8AAAAAAAAAAAAAAAAAAAAAAAAAAAAAAA\n",
// (char*)  "SBR CP8 AAAAAAAAAAAAAAAP//8AAAAAAAAAAAAAAAAAAAAAAAAAAAAAAA\n",
// (char*)  "SBR CQn AAAAAAAAAAAAAAAD///AAAAAAAAAAAAAAAAAAAAAAAAAAAAAAA\n",
// (char*)  "SBR CRR AAAAAAAAAAAAAAAB///gAAAAAAAAAAAAAAAAAAAAAAAAAAAAAA\n",
// (char*)  "SBR CR7 AAAAAAAAAAAAAAAAf//gAAAAAAAAAAAAAAAPAAAAAAAAAAAAAA\n",
// (char*)  "SBR CSm AAAAAAAAAAAAAAAAf//4AAAAAAAAAAAAAAAeAAAAAAAAAAAAAA\n",
// (char*)  "SBR CTQ AAAAAAAAAAAAAAAAH//+AAAAAAAAAAAAAAH8AAAAAAAAAAAAAA\n",
// (char*)  "SBR CT6 AAAAAAAAAAAAAAAAD//+AAAAAAAAAAAAAAPwAAAAAAAAAAAAAA\n",
// (char*)  "SBR CUl AAAAAAAAAAAAAAAAB///wAAAAAAAAAAAAD/gAAAAAAAAAAAAAA\n",
// (char*)  "SBR CVP AAAAAAAAAAAAAAAAAf//4AAAAAAAAAAAAf/AAAAAAAAAAAAAAA\n",
// (char*)  "SBR CV5 AAAAAAAAAAAAAAAAAP//+AAAAAAAAAAAB/8AAAAAAAAAAAAAAA\n",
// (char*)  "SBR CWk AAAAAAAAAAAAAAAAAH///AAAAAAAAAAAP/wAAAAAAAAAAAAAAA\n",
// (char*)  "SBR CXO AAAAAAAAAAAAAAAAAB///4AAAAAAAAAAf/AAAAAAAAAAAAAAAA\n",
// (char*)  "SBR CX4 AAAAAAAAAAAAAAAAAA////AAAAAAAAAD/wAAAAAAAAAAAAAAAA\n",
// (char*)  "SBR CYj AAAAAAAAAAAAAAAAAAP///4AAAAAAAA//AAAAAAAAAAAAAAAAA\n",
// (char*)  "SBR CZN AAAAAAAAAAAAAAAAAAH///9AAAAAAAH/+AAAAAAAAAAAAAAAAA\n",
// (char*)  "SBR CZ3 AAAAAAAAAAAAAAAAAAA////oAAAAAAf/gAAAAAAAAAAAAAAAAA\n",
// (char*)  "SBR Cai AAAAAAAAAAAAAAAAAAAf///+gAAAAL/8AAAAAAAAAAAAAAAAAA\n",
// (char*)  "SBR CbM AAAAAAAAAAAAAAAAAAAH////9AAAF//4AAAAAAAAAAAAAAAAAA\n",
// (char*)  "SBR Cb2 AAAAAAAAAAAAAAAAAAAD/////+/8///AAAAAAAAAAAAAAAAAAA\n",
// (char*)  "SBR Cch AAAAAAAAAAAAAAAAAAAAf/////////4AAAAAAAAAAAAAAAAAAA\n",
// (char*)  "SBR CdL AAAAAAAAAAAAAAAAAAAAH////////9AAAAAAAAAAAAAAAAAAAA\n",
// (char*)  "SBR Cd1 AAAAAAAAAAAAAAAAAAAAB////////gAAAAAAAAAAAAAAAAAAAA\n",
// (char*)  "SBR Ceg AAAAAAAAAAAAAAAAAAAAAP//////6AAAAAAAAAAAAAAAAAAAAA\n",
// (char*)  "SBR CfK AAAAAAAAAAAAAAAAAAAAABf////+gAAAAAAAAAAAAAAAAAAAAA\n",
// (char*)  "SBR Cf0 AAAAAAAAAAAAAAAAAAAAAAF////QAAAAAAAAAAAAAAAAAAAAAA\n",
// (char*)  "SBR Cgf AAAAAAAAAAAAAAAAAAAAAAACP+QAAAAAAAAAAAAAAAAAAAAAAA\n",
// (char*)  "SBR ChJ AAAAAAAAAAAAAAAAAAAAAAAAAAAAAAAAAAAAAAAAAAAAAAAAAA\n",
// (char*)  "SBR DWE AAAAAAAAAAAAAAAAAAAAAAAAAAAAAAAAAAAAAAAAAAAAAAAAAA\n"

// (char*) "SBR O9 AAAAAAAAAAAAAAAAAAAAAAAAAAAAAAAAAAAAAAAAAAAAAAAAAA",  // KSU logo, 269 lines
// (char*) "SBR QS AAAP/////////////////////wAAAAAAAAAAAAAAAAAAAAAAAA",
// (char*) "SBR Q8 AAAf/////////////////////AAAAAAAAAAAAAAAAAAAAAAAAA",
// (char*) "SBR Rn AAAf////////////////////+AAAAAAAAAAAAAAAAAAAAAAAAA",
// (char*) "SBR SR AAAf////////////////////8AAAAAAAAAAAAAAAAAAAAAAAAA",
// (char*) "SBR S7 AAAf////////////////////4AAAAAAAAAAAAAAAAAAAAAAAAA",
// (char*) "SBR Tm AAA/////////////////////wAAAAAAAAAAAAAAAAAAAAAAAAA",
// (char*) "SBR UQ AAA/////////////////////gAAAAAAAAAAAAAAAAAAAAAAAAA",
// (char*) "SBR U6 AAA/////////////////////AAAAAAAAAAAAAAAAAAAAAAAAAA",
// (char*) "SBR Vl AAB////////////////////8AAAAAAAAAAAAAAAAAAAAAAAAAA",
// (char*) "SBR WP AAB////////////////////4AAAAAAAAAAAAAAAAAAAAAAAAAA",
// (char*) "SBR W5 AAB////////////////////wAAAAAAAAAAAAAAAAAAAAAAAAAA",
// (char*) "SBR Xk AAD////////////////////gAAAAAAAAAAAAAAAAAAAAAAAAAA",
// (char*) "SBR YO AAD////////////////////AAAAAAAAAAAAAAAAAAAAAAAAAAA",
// (char*) "SBR Y4 AAD///////////////////+AAAAAAAAAAAAAAAAAAAAAAAAAAA",
// (char*) "SBR Zj AAH///////////////////8AAAAAAAAAAAAAAAAAAAAAAAAAAA",
// (char*) "SBR aN AAH///////////////////4AAAAAAAAAAAAAAAAAAAAAAAAAAA",
// (char*) "SBR bi AAP///////////////////wAAAAAAAAAAAAAAAAAAAAAAAAAAA",
// (char*) "SBR cM AAP///////////////////gAAAAAAAAAAAAAAAAAAAAAAAAAAA",
// (char*) "SBR c2 AAP///////////////////AAAAAAAAAAAAAAAAAAAAAAAAAAAA",
// (char*) "SBR dh AAf//////////////////+AAAAAAAAAAAAAAAAAAAAAAAAAAAA",
// (char*) "SBR eL AAf//////////////////8AAAAAAAAAAAAAAAAAAAAAAAAAAAA",
// (char*) "SBR e1 AAf//////////////////4AAAAAAAAAAAAAAAAAAAAAAAAAAAA",
// (char*) "SBR fg AA///////////////////wAAAAAAAAAAAAAAAAAAAAAAAAAAAA",
// (char*) "SBR g0 AA///////////////////gAAAAAAAAAAAAAAAAAAAAAAAAAAAA",
// (char*) "SBR hf AB///////////////////AAAAAH//wAAAAAAAAAAAAAAAAAAAA",
// (char*) "SBR iJ AB//////////////////+AAAAB////AAAAAAAAAAAAAAAAAAAA",
// (char*) "SBR iz AB//////////////////+AAAAf////4AAAAAAAAAAAAAAAAAAA",
// (char*) "SBR je AD//////////////////8AAAB/////+AAAAAAAAAAAAAAAAAAA",
// (char*) "SBR kI AD//////////////////4AAAH//////gAAAAAAAAAAAAAAAAAA",
// (char*) "SBR ky AD//////////////////wAAAf//////4AAAAAAAAAAAAAAAAAA",
// (char*) "SBR ld AD//////////////////wAAB///////8AAAAAAAAAAAAAAAAAA",
// (char*) "SBR mH AA//////////////////gAAH////////AAAAAAAAAAAAAAAAAA",
// (char*) "SBR mx AAf/////////////////AAAP////////gAAAAAAAAAAAAAAAAA",
// (char*) "SBR nc AAP/////////////////AAA/////////4AAAAAAAAAAAAAAAAA",
// (char*) "SBR oG AAH////////////////+AAB/////////8AAAAAAAAAAAAAAAAA",
// (char*) "SBR ow AAD////////////////8AAD//////////AAAAAAAAAAAAAAAAA",
// (char*) "SBR pb EAB////////////////8AAP//////////gAAAAAAAAAAAAAAAA",
// (char*) "SBR qF HAA////////////////4AAf//////////wAAAAAAAAAAAAAAAA",
// (char*) "SBR qv HgAf///////////////wAA///////////4AAAAAAAAAAAAAAAA",
// (char*) "SBR ra HwAP///////////////wAB///////////8AAAAAAAAAAAAAAAA",
// (char*) "SBR sE H4AH///////////////gAD///////////+AAAAAAAAAAAAAAAA",
// (char*) "SBR su H8AD///////////////gAH////////////AAAAAAAAAAAAAAAA",
// (char*) "SBR tZ H+AB///////////////AAP////////////gAAAAAAAAAAAAAAA",
// (char*) "SBR uD H/AA//////////////+AAP////////////wAAAAAAAAAAAAAAA",
// (char*) "SBR ut H/gA//////////////+AAf////////////4AAAAAAAAAAAAAAA",
// (char*) "SBR vY H/wAf/////////////8AA/////////////8AAAAAAAAAAAAAAA",
// (char*) "SBR wC H/4AP/////////////8AB/////////////+AAAAAAAAAAAAAAA",
// (char*) "SBR ws H/8AH/////////////4AD/////////////+AAAAAAAAAAAAAAA",
// (char*) "SBR xX H/+AH/////////////4AD//////////////AAAAAAAAAAAAAAA",
// (char*) "SBR yB H//AD/////////////wAH//////////////gAAAAAAAAAAAAAA",
// (char*) "SBR yr H//gB/////////////wAP//////////////gAAAAAAAAAAAAAA",
// (char*) "SBR zW H//wB/////////////gAP//////////////wAAAAAAAAAAAAAA",
// (char*) "SBR 0A H//wA/////////////gAf//////////////4AAAAAAAAAAAAAA",
// (char*) "SBR 0q H//4Af////////////AA///////////////4AAAAAAAAAAAAAA",
// (char*) "SBR 1V H//8Af////////////AA///////////////8AAAAAAAAAAAAAA",
// (char*) "SBR 1/ H//8AP///////////+AB///////////////8AAAAAAAAAAAAAA",
// (char*) "SBR 2p H//+AP///////////+AB///////////////+AAAAAAAAAAAAAA",
// (char*) "SBR 3U H///AH///////////8AD///////////////+AAAAAAAAAAAAAA",
// (char*) "SBR 3+ H///AH///////////8AD////////////////AAAAAAAAAAAAAA",
// (char*) "SBR 4o H///gD///////////8AH////////////////AAAAAAAAAAAAAA",
// (char*) "SBR 5T H///gD///////////4AH////////////////gAAAAAAAAAAAAA",
// (char*) "SBR 59 H///wD///////////4AP////////////////gAAAAAAAAAAAAA",
// (char*) "SBR 6n H///wB///////////wAP////////////////gAAAAAAAAAAAAA",
// (char*) "SBR 7S H///4B///////////wAf////////////////wAAAAAAAAAAAAA",
// (char*) "SBR 78 H///4A///////////wAf////////////////wAAAAAAAAAAAAA",
// (char*) "SBR 8m H///4A///////////gA/////////////////wAAAAAAAAAAAAA",
// (char*) "SBR 9R H///8A///////////gA/////////////////4AAAAAAAAAAAAA",
// (char*) "SBR 97 H///8A///////////gB/////////////////4AAAAAAAAAAAAA",
// (char*) "SBR +l H///8Af//////////AB/////////////////4AAAAAAAAAAAAA",
// (char*) "SBR /Q H///+Af//////////AB/////////////////8AAAAAAAAAAAAA",
// (char*) "SBR /6 H///+Af//////////AD/////////////////8AAAAAAAAAAAAA",
// (char*) "SBR BAk H///+Af/////////+AD/////////////////8AAAAAAAAAAAAA",
// (char*) "SBR BBP H///+AP/////////+AH/////////////////8AAAAAAAAAAAAA",
// (char*) "SBR BB5 H////AP/////////+AH/////////////////8AAAAAAAAAAAAA",
// (char*) "SBR BCj H////AP/////////8AH/////////////////8AAAAAAAAAAAAA",
// (char*) "SBR BDO H////AP/////////8AP/////////////////+AAAAAAAAAAAAA",
// (char*) "SBR BEi H////AP/////////4AP/////////////////+AAAAAAAAAAAAA",
// (char*) "SBR BF3 H////AP/////////4Af/////////////////+AAAAAAAAAAAAA",
// (char*) "SBR BHM H////AP/////////wAf/////////////////+AAAAAAAAAAAAA",
// (char*) "SBR BH2 H////AP/////////wA//////////////////+AAAAAAAAAAAAA",
// (char*) "SBR BJ1 H////AP/////////gA//////////////////+AAAAAAAAAAAAA",
// (char*) "SBR BLK H////AP/////////gB//////////////////+AAAAAAAAAAAAA",
// (char*) "SBR BNJ H////AP/////////AB//////////4AB/////+AAAAAAAAAAAAA",
// (char*) "SBR BNz H////AP/////////AB/////////+AAAD////+AAAAAAAAAAAAA",
// (char*) "SBR BOd H///+Af/////////AD/////////gAAAAP///+AAAAAAAAAAAAA",
// (char*) "SBR BPI H///+Af/////////AD////////+AAAAAB///+AAAAAAAAAAAAA",
// (char*) "SBR BPy H///+Af/////////AD////////wAAAAAAf//+AAAAAAAAAAAAA",
// (char*) "SBR BQc H///8A/////////+AD////////AAAAAAAH//+AAAAAAAAAAAAA",
// (char*) "SBR BRH H///8A/////////+AD///////8AAAAAAAB//+AAAAAAAAAAAAA",
// (char*) "SBR BRx H///8A/////////+AD///////wAAAAAAAAf/+AAAAAAAAAAAAA",
// (char*) "SBR BSb H///4B/////////+AH///////AAAAAAAAAH/8AAAAAAAAAAAAA",
// (char*) "SBR BTG H///wB/////////+AH//////8AAAAAAAAAD/8AAAAAAAAAAAAA",
// (char*) "SBR BTw H///wD/////////+AH//////4AAAAAAAAAA/8AAAAAAAAAAAAA",
// (char*) "SBR BUa H///gD/////////+AH//////gAAAAAAAAAAf8AAAAAAAAAAAAA",
// (char*) "SBR BVF H///AH/////////8AH//////AAAAAAAAAAAH8AAAAAAAAAAAAA",
// (char*) "SBR BVv H//+AP/////////8AH/////+AAAAAAAAAAAD8AAAAAAAAAAAAA",
// (char*) "SBR BWZ H//8AP/////////8AH/////8AAAAAAAAAAAB4AAAAAAAAAAAAA",
// (char*) "SBR BXE H//wAf/////////8AP/////4AAAAAAAAAAAA4AAAAAAAAAAAAA",
// (char*) "SBR BXu H//AA//////////8AP/////wAAAAAAAAAAAAIAAAAAAAAAAAAA",
// (char*) "SBR BYY H/8AB//////////8AP/////gAAAAAAAAAAAAAAAAAAAAAAAAAA",
// (char*) "SBR BZD H/AAD//////////8AP/////AAAAAAAAAAAAAAAAAAAAAAAAAAA",
// (char*) "SBR BZt AAAAH//////////8AP////+AAAAAAAAAAAAAAAAAAAAAAAAAAA",
// (char*) "SBR BaX AAAAf//////////8AP////8AAAAAAAAAAAAAAAAAAAAAAAAAAA",
// (char*) "SBR BbC AAAA///////////8AP////4AAAAAAAAAAAAAAAAAAAAAAAAAAA",
// (char*) "SBR Bbs AAAD///////////8AP////wAAAAAAAAAAAAAAAAAAAAAAAAAAA",
// (char*) "SBR BcW AAAP///////////8AP////wAAAAAAAAAAAAAAAAAAAAAAAAAAA",
// (char*) "SBR BdB AAA////////////4AP////gAAAAAAAAAAAAAAAAAAAAAAAAAAA",
// (char*) "SBR Bdr AAH////////////4AP////AAAAAAAAAAAAAAAAAAAAAAAAAAAA",
// (char*) "SBR BeV Of/////////////4Af///+AAAAAAAAAAAAAAAAAAAAAAAAAAAA",
// (char*) "SBR BfA P//////////////4Af///+AAAAAAAAAAAAAAAAAAAAAAAAAAAA",
// (char*) "SBR Bfq P//////////////4Af///8AAAAAAAAAAAAAAAAAAAAAAAAAAAA",
// (char*) "SBR Bg/ P//////////////4Af///4AAAAAAAAAAAAAAAAAAAAAAAAAAAA",
// (char*) "SBR BiT P//////////////4Af///wAAAAAAAAAAAAAAAAAAAAAAAAAAAA",
// (char*) "SBR Bi+ P//////////////4Af///wAAAAA//wAAAAAAAAAAAAAAAAAAAA",
// (char*) "SBR Bjo P//////////////4Af///gAAAAH///AAAAAAAAAAAAAAAAAAAA",
// (char*) "SBR BkS P//////////////4Af///gAAAA////wAAAAAAAAAAAAAAAAAAA",
// (char*) "SBR Bk9 f//////////////4Af///AAAAD////+AAAAAAAAAAAAAAAAAAA",
// (char*) "SBR Bln f//////////////4Af///AAAAP/////gAAAAAAAAAAAAAAAAAA",
// (char*) "SBR BmR f//////////////4Af///AAAAf/////4AAAAAAAAAAAAAAAAAA",
// (char*) "SBR Bm8 f//////////////4Af//+AAAB//////8AAAAAAAAAAAAAAAAAA",
// (char*) "SBR Bnm f//////////////4Af//+AAAD///////AAAAAAAAAAAAAAAAAA",
// (char*) "SBR BoQ f//////////////4Af//+AAAH///////wAAAAAAAAAAAAAAAAA",
// (char*) "SBR Bo7 f//////////////4Af//8AAAP///////4AAAAAAAAAAAAAAAAA",
// (char*) "SBR Bpl f//////////////4Af//8AAAf///////8AAAAAAAAAAAAAAAAA",
// (char*) "SBR BqP f//////////////4Af//8AAA////////+AAAAAAAAAAAAAAAAA",
// (char*) "SBR Bq6 f//////////////4Af//4AAB/////////gAAAAAAAAAAAAAAAA",
// (char*) "SBR Brk f//////////////8Af//4AAD/////////wAAAAAAAAAAAAAAAA",
// (char*) "SBR BsO f//////////////8Af//4AAH/////////4AAAAAAAAAAAAAAAA",
// (char*) "SBR Bs5 f//////////////8Af//4AAP/////////wAAAAAAAAAAAAAAAA",
// (char*) "SBR Btj f//////////////8Af//wAAf/////////AAAAAAAAAAAAAAAAA",
// (char*) "SBR BuN f//////////////8Af//wAAf////////8AAAAAAAAAAAAAAAAA",
// (char*) "SBR Bu4 f//////////////8Af//wAA/////////4AAAAAAAAAAAAAAAAA",
// (char*) "SBR Bvi f//////////////8Af//wAB/////////wAAAAAAAAAAAAAAAAA",
// (char*) "SBR BwM f//////////////8Af//wAD/////////gAAAAAAAAAAAAAAAAA",
// (char*) "SBR Bw3 f//////////////8Af//wAD/////////AAAAAAAAAAAAAAAAAA",
// (char*) "SBR Bxh f//////////////8Af//gAH////////+AAAAAAAAAAAAAAAAAA",
// (char*) "SBR ByL f//////////////8AP//gAH////////8AAAAAAAAAAAAAAAAAA",
// (char*) "SBR By2 f//////////////8AP//gAP////////4AAAAAAAAAAAAAAAAAA",
// (char*) "SBR Bzg f//////////////+AP//gAP////////4AAAAAAAAAAAAAAAAAA",
// (char*) "SBR B0K f//////////////+AP//gAP////////wAAAAAAAAAAAAAAAAAA",
// (char*) "SBR B01 f//////////////+AP//gAf////////gAAAAAAAAAAAAAAAAAA",
// (char*) "SBR B2J P//////////////+AP//gAf////////AAAAAAAAAAAAAAAAAAA",
// (char*) "SBR B20 P//////////////+AP//gA/////////AAAAAAAAAAAAAAAAAAA",
// (char*) "SBR B3e P//////////////+AP//gA////////+AAAAAAAAAAAAAAAAAAA",
// (char*) "SBR B4I P///////////////AP//AA////////+AAAAAAAAAAAAAAAAAAA",
// (char*) "SBR B4z P///////////////AP//AB////////8AAAAAAAAAAAAAAAAAAA",
// (char*) "SBR B5d P///////////////AH//AB////////8AAAAAAAAAAAAAAAAAAA",
// (char*) "SBR B6H P///////////////AH//AB////////4AAAAAAAAAAAAAAAAAAA",
// (char*) "SBR B8x P///////////////gH//AD////////wAAAAAAAAAAAAAAAAAAA",
// (char*) "SBR B+F H///////////////gD//AD////////wAAAAAAAAAAAAAAAAAAA",
// (char*) "SBR CAE H///////////////wD//gD////////wAAAAAAAAAAAAAAAAAAA",
// (char*) "SBR CCD H///////////////wB//gD////////wAAAAAAAAAAAAAAAAAAA",
// (char*) "SBR CDY D///////////////4B//gD////////wAAAAAAAAAAAAAAAAAAA",
// (char*) "SBR CEC D///////////////4B//gD////////4AAAAAAAAAAAAAAAAAAA",
// (char*) "SBR CFX D///////////////4A//gD////////4AAAAAAAAAAAAAAAAAAA",
// (char*) "SBR CGB D///////////////8A//gD////////8AAAAAAAAAAAAAAAAAAA",
// (char*) "SBR CHW B///////////////8A//wD////////+AAAAAAAAAAAAAAAAAAA",
// (char*) "SBR CIr B///////////////+Af/wB/////////AAAAAAAAAAAAAAAAAAA",
// (char*) "SBR CJ/ B///////////////+Af/wB/////////gAAAAAAAAAAAAAAAAAA",
// (char*) "SBR CKq A///////////////+Af/wB/////////wAAAAAAAAAAAAAAAAAA",
// (char*) "SBR CLU A////////////////AP/wB/////////wAAAAAAAAAAAAAAAAAA",
// (char*) "SBR CL+ A////////////////AP/4B/////////4AAAAAAAAAAAAAAAAAA",
// (char*) "SBR CMp A////////////////AP/4B/////////8AAAAAAAAAAAAAAAAAA",
// (char*) "SBR CNT Af///////////////gP/4A/////////+AAAAAAAAAAAAAAAAAA",
// (char*) "SBR CN9 Af///////////////gH/4A//////////AAAAAAAAAAAAAAAAAA",
// (char*) "SBR COo Af///////////////gH/4Af/////////gAAAAAAAAAAAAAAAAA",
// (char*) "SBR CPS Af///////////////wH/gAD/////////wAAAAAAAAAAAAAAAAA",
// (char*) "SBR CP8 AP///////////////wH4AAAf////////4AAAAAAAAAAAAAAAAA",
// (char*) "SBR CQn AP///////////////wDAAAAH////////8AAAAAAAAAAAAAAAAA",
// (char*) "SBR CRR AP///////////////4AAAAAD/////////AAAAAAAAAAAAAAAAA",
// (char*) "SBR CR7 AP///////////////4AAAAAA/////////gAAAAAAAAAAAAAAAA",
// (char*) "SBR CSm AH///////////////4AAAAAAf////////wAAAAAAAAAAAAAAAA",
// (char*) "SBR CTQ AH///////////////8AAAAAAP////////gAAAAAAAAAAAAAAAA",
// (char*) "SBR CT6 AH///////////////8AAAAAAD////////gAAAAAAAAAAAAAAAA",
// (char*) "SBR CUl AD///////////////wAAAAAAD////////gAAAAAAAAAAAAAAAA",
// (char*) "SBR CVP AD///////////////gAAAAAAB////////gAAAAAAAAAAAAAAAA",
// (char*) "SBR CV5 AD/P/////////////AAAAAAAA////////AAAAAAAAAAAAAAAAA",
// (char*) "SBR CWk AD/P////////////+AAAAAAAAf///////AAAAAAAAAAAAAAAAA",
// (char*) "SBR CXO AB/H////////////4AAAAAAAAf//////+AAAAAAAAAAAAAAAAA",
// (char*) "SBR CX4 AB/H////////////wAAAAAAAAP//////+AAAAAAAAAAAAAAAAA",
// (char*) "SBR CYj AB/H////////////gAAAAAAAAP//////+AAAAAAAAAAAAAAAAA",
// (char*) "SBR CZN AA/H////////////AAAAAAAAAP//////8AAAAAAAAAAAAAAAAA",
// (char*) "SBR Cai AAfH///////////+AAAAAAAAAH//////4AAAAAAAAAAAAAAAAA",
// (char*) "SBR CbM AAfH///////////8AAAAAAAAAH//////4AAAAAAAAAAAAAAAAA",
// (char*) "SBR Cb2 AAfD///////////4AAAAAAAAAH//////wAAAAAAAAAAAAAAAAA",
// (char*) "SBR Cch AAPD///////////wAAAAAAAAAH//////gAAAAAAAAAAAAAAAAA",
// (char*) "SBR Cd1 AAHD///////////gAAAAAAAAAH//////AAAAAAAAAAAAAAAAAA",
// (char*) "SBR Ceg AAHD///////////AAAAAAAAAAH/////+AAAAAAAAAAAAAAAAAA",
// (char*) "SBR CfK AAHB///////////AAAAAAAAAAP/////+AAAAAAAAAAAAAAAAAA",
// (char*) "SBR Cf0 AADB//////////+AAAAAAAAAAP/////8AAAAAAAAAAAAAAAAAA",
// (char*) "SBR Cgf AADB//////////+AAAAAAAAAAP/////4AAAAAAAAAAAAAAAAAA",
// (char*) "SBR ChJ AABB//////////+AAAAAAAAAAP/////4AAAAAAAAAAAAAAAAAA",
// (char*) "SBR Chz AABA//////////8AAAAAAAAAAf/////wAAAAAAAAAAAAAAAAAA",
// (char*) "SBR Cie AAAA//////////8AAAAAAAAAAf/////gAAAAAAAAAAAAAAAAAA",
// (char*) "SBR CjI AAAA//////////4AAAAAAAAAAf/////AAAAAAAAAAAAAAAAAAA",
// (char*) "SBR Cjy AAAA//////////4AAAAAAAAAAf////+AAAAAAAAAAAAAAAAAAA",
// (char*) "SBR Ckd AAAAf/////////4AAAAAAAAAA/////+AAAAAAAAAAAAAAAAAAA",
// (char*) "SBR ClH AAAAf/////////4AAAAAAAAAA/////8AAAAAAAAAAAAAAAAAAA",
// (char*) "SBR Clx AAAAf/////////4AAAAAAAAAB/////4AAAAAAAAAAAAAAAAAAA",
// (char*) "SBR Cmc AAAAf/////////wAAAAAAAAAB/////wAAAAAAAAAAAAAAAAAAA",
// (char*) "SBR CnG AAAAP/////////wAAAAAAAAAD/////gAAAAAAAAAAAAAAAAAAA",
// (char*) "SBR Cnw AAAAP/////////wAAAAAAAAAD/////AAAAAAAAAAAAAAAAAAAA",
// (char*) "SBR Cob AAAAP/////////wAAAAAAAAAH////+AAAAAAAAAAAAAAAAAAAA",
// (char*) "SBR CpF AAAAP/////////wAAAAAAAAAP////8AAAAAAAAAAAAAAAAAAAA",
// (char*) "SBR Cpv AAAAH/////////4AAAAAAAAAP////4AAAAAAAAAAAAAAAAAAAA",
// (char*) "SBR Cqa AAAAH/////////4AAAAAAAAAf////wAAAAAAAAAAAAAAAAAAAA",
// (char*) "SBR CrE AAAAH/////////4AAAAAAAAA/////gAAAAAAAAAAAAAAAAAAAA",
// (char*) "SBR Cru AAAAH/////////4AAAAAAAAB/////AAAAAAAAAAAAAAAAAAAAA",
// (char*) "SBR CsZ AAAAD/////////8AAAAAAAAD////+AAAAAAAAAAAAAAAAAAAAA",
// (char*) "SBR CtD AAAAD/////////8AAAAAAAAH////8AAAAAAAAAAAAAAAAAAAAA",
// (char*) "SBR Ctt AAAAD/////////8AAAAAAAAP////4AAAAAAAAAAAAAAAAAAAAA",
// (char*) "SBR CuY AAAAB/////////8AAAAAAAAf/h//wAAAAAAAAAAAAAAAAAAAAA",
// (char*) "SBR CvC AAAAB/////////+AAAAAAAB/+B//gAAAAAAAAAAAAAAAAAAAAA",
// (char*) "SBR Cvs AAAAB/////////+AAAAAAAD/wA//AAAAAAAAAAAAAAAAAAAAAA",
// (char*) "SBR CwX AAAAA/////////+AAAAAAAH8AAf8AAAAAAAAAAAAAAAAAAAAAA",
// (char*) "SBR CxB AAAAA//////////AAAAAAAAAAAP4AAAAAAAAAAAAAAAAAAAAAA",
// (char*) "SBR Cxr AAAAA//////////AAAAAAAAAAAHwAAAAAAAAAAAAAAAAAAAAAA",
// (char*) "SBR CyW AAAAAf/////////gAAAAAAAAAADgAAAAAAAAAAAAAAAAAAAAAA",
// (char*) "SBR CzA AAAAAf/////////gAAAAAAAAAAAAAAAAAAAAAAAAAAAAAAAAAA",
// (char*) "SBR Czq AAAAAf/////////wAAAAAAAAAAAAAAAAAAAAAAAAAAAAAAAAAA",
// (char*) "SBR C0V AAAAAP/////////4AAAAAAAAAAAAAAAAAAAAAAAAAAAAAAAAAA",
// (char*) "SBR C0/ AAAAAP/////////8AAAAAAAAAAAAAAAAAAAAAAAAAAAAAAAAAA",
// (char*) "SBR C1p AAAAAP/////////+AAAAAAAAAAAAAAAAAAAAAAAAAAAAAAAAAA",
// (char*) "SBR C2U AAAAAH//////////AAAAAAAAAAAAAAAAAAAAAAAAAAAAAAAAAA",
// (char*) "SBR C2+ AAAAAH//////////wAAAAAAAAAAAAAAAAAAAAAAAAAAAAAAAAA",
// (char*) "SBR C3o AAAAAH//////////8AAEAAAAAAAAAAAAAAAAAAAAAAAAAAAAAA",
// (char*) "SBR C4T AAAAAD///////////gD4AAAAAAAAAAAAAAAAAAAAAAAAAAAAAA",
// (char*) "SBR C49 AAAAAD/////////////4AAAAAAAAAAAAAAAAAAAAAAAAAAAAAA",
// (char*) "SBR C5n AAAAAD/////////////wAAAAAAAAAAAAAAAAAAAAAAAAAAAAAA",
// (char*) "SBR C6S AAAAAB/////////////gAAAAAAAAAAAAAAAAAAAAAAAAAAAAAA",
// (char*) "SBR C68 AAAAAB/////////////AAAAAAAAAAAAAAAAAAAAAAAAAAAAAAA",
// (char*) "SBR C7m AAAAAA////////////+AAAAAAAAAAAAAAAAAAAAAAAAAAAAAAA",
// (char*) "SBR C8R AAAAAA////////////4AAAAAAAAAAAAAAAAAAAAAAAAAAAAAAA",
// (char*) "SBR C87 AAAAAA////////////wAAAAAAAAAAAAAAAAAAAAAAAAAAAAAAA",
// (char*) "SBR C9l AAAAAAf///////////AAAAAAAAAAAAAAAAAAAAAAAAAAAAAAAA",
// (char*) "SBR C+Q AAAAAAf//////////8AAAAAAAAAAAAAAAAAAAAAAAAAAAAAAAA",
// (char*) "SBR C+6 AAAAAAP//////////wAAAAAAAAAAAAAAAAAAAAAAAAAAAAAAAA",
// (char*) "SBR C/k AAAAAAP//////////AAAAAAAAAAAAAAAAAAAAAAAAAAAAAAAAA",
// (char*) "SBR DAP AAAAAAH//////////AAAAAAAAAAAAAAAAAAAAAAAAAAAAAAAAA",
// (char*) "SBR DA5 AAAAAAH//////////gAAAAAAAAAAAAAAAAAAAAAAAAAAAAAAAA",
// (char*) "SBR DCO AAAAAAD//////////gAAAAAAAAAAAAAAAAAAAAAAAAAAAAAAAA",
// (char*) "SBR DDi AAAAAAB//////////gAAAAAAAAAAAAAAAAAAAAAAAAAAAAAAAA",
// (char*) "SBR DEN AAAAAAB//////////wAAAAAAAAAAAAAAAAAAAAAAAAAAAAAAAA",
// (char*) "SBR DE3 AAAAAAA//////////wAAAAAAAAAAAAAAAAAAAAAAAAAAAAAAAA",
// (char*) "SBR DGM AAAAAAAf/////////wAAAAAAAAAAAAAAAAAAAAAAAAAAAAAAAA",
// (char*) "SBR DG2 AAAAAAAf/////////gAAAAAAAAAAAAAAAAAAAAAAAAAAAAAAAA",
// (char*) "SBR DHg AAAAAAAP/////////AAAAAAAAAAAAAAAAAAAAAAAAAAAAAAAAA",
// (char*) "SBR DIL AAAAAAAP////////+AAAAAAAAAAAAAAAAAAAAAAAAAAAAAAAAA",
// (char*) "SBR DI1 AAAAAAAH////////4AAAAAAAAAAAAAAAAAAAAAAAAAAAAAAAAA",
// (char*) "SBR DJf AAAAAAAD////////wAAAAAAAAAAAAAAAAAAAAAAAAAAAAAAAAA",
// (char*) "SBR DKK AAAAAAAD////////gAAAAAAAAAAAAAAAAAAAAAAAAAAAAAAAAA",
// (char*) "SBR DK0 AAAAAAAB///////+AAAAAAAAAAAAAAAAAAAAAAAAAAAAAAAAAA",
// (char*) "SBR DLe AAAAAAAB///////8AAAAAAAAAAAAAAAAAAAAAAAAAAAAAAAAAA",
// (char*) "SBR DMJ AAAAAAAA///////wAAAAAAAAAAAAAAAAAAAAAAAAAAAAAAAAAA",
// (char*) "SBR DMz AAAAAAAA///////AAAAAAAAAAAAAAAAAAAAAAAAAAAAAAAAAAA",
// (char*) "SBR DNd AAAAAAAAf/////+AAAAAAAAAAAAAAAAAAAAAAAAAAAAAAAAAAA",
// (char*) "SBR DOI AAAAAAAAP/////4AAAAAAAAAAAAAAAAAAAAAAAAAAAAAAAAAAA",
// (char*) "SBR DOy AAAAAAAAP/////gAAAAAAAAAAAAAAAAAAAAAAAAAAAAAAAAAAA",
// (char*) "SBR DPc AAAAAAAAH////+AAAAAAAAAAAAAAAAAAAAAAAAAAAAAAAAAAAA",
// (char*) "SBR DQH AAAAAAAAD////4AAAAAAAAAAAAAAAAAAAAAAAAAAAAAAAAAAAA",
// (char*) "SBR DQx AAAAAAAAD////gAAAAAAAAAAAAAAAAAAAAAAAAAAAAAAAAAAAA",
// (char*) "SBR DRb AAAAAAAAB///+AAAAAAAAAAAAAAAAAAAAAAAAAAAAAAAAAAAAA",
// (char*) "SBR DSG AAAAAAAAA///wAAAAAAAAAAAAAAAAAAAAAAAAAAAAAAAAAAAAA",
// (char*) "SBR DSw AAAAAAAAAf//AAAAAAAAAAAAAAAAAAAAAAAAAAAAAAAAAAAAAA",
// (char*) "SBR DTa AAAAAAAAAf/4AAAAAAAAAAAAAAAAAAAAAAAAAAAAAAAAAAAAAA",
// (char*) "SBR DUF AAAAAAAAAP/AAAAAAAAAAAAAAAAAAAAAAAAAAAAAAAAAAAAAAA",
// (char*) "SBR DUv AAAAAAAAAHwAAAAAAAAAAAAAAAAAAAAAAAAAAAAAAAAAAAAAAA",
// (char*) "SBR DWE AAAAAAAAAAAAAAAAAAAAAAAAAAAAAAAAAAAAAAAAAAAAAAAAAA"


    // (char*)  "SBR uN AAAAAAAAAAAAAAAAAAAAAAAAAAAAAAAAAAAAAAAAAAAAAAAAAA",   // 242 Lines, alignment test w/ thick margin
    // (char*) "SBR BCu AAAAA////////////////////////////////////////AAAA/",
    // (char*) "SBR BDY AAAAAwAAAAAAAAAAAAAAAAAAAAAAAAAAAAAAAAAAAAAADAAAAA",
    // (char*) "SBR BEC AAAAAoAAAAAAAAAAAAAAAAAAAAAAAAAAAAAAAAAAAAAAFAAAAA",
    // (char*) "SBR BEt AAAAAkAAAAAAAAAAAAAAAAAAAAAAAAAAAAAAAAAAAAAAJAAAAA",
    // (char*) "SBR BFX AAAAAiAAAAAAAAAAAAAAAAAAAAAAAAAAAAAAAAAAAAAARAAAAA",
    // (char*) "SBR BGB AAAAAhAAAAAAAAAAAAAAAAAAAAAAAAAAAAAAAAAAAAAAhAAAAA",
    // (char*) "SBR BGs AAAAAggAAAAAAAAAAAAAAAAAAAAAAAAAAAAAAAAAAAABBAAAAA",
    // (char*) "SBR BHW AAAAAgQAAAAAAAAAAAAAAAAAAAAAAAAAAAAAAAAAAAACBAAAAA",
    // (char*) "SBR BIA AAAAAgIAAAAAAAAAAAAAAAAAAAAAAAAAAAAAAAAAAAAEBAAAAA",
    // (char*) "SBR BIr AAAAAgEAAAAAAAAAAAAAAAAAAAAAAAAAAAAAAAAAAAAIBAAAAA",
    // (char*) "SBR BJV AAAAAgCAAAAAAAAAAAAAAAAAAAAAAAAAAAAAAAAAAAAQBAAAAA",
    // (char*) "SBR BJ/ AAAAAgBAAAAAAAAAAAAAAAAAAAAAAAAAAAAAAAAAAAAgBAAAAA",
    // (char*) "SBR BKq AAAAAgAgAAAAAAAAAAAAAAAAAAAAAAAAAAAAAAAAAABABAAAAA",
    // (char*) "SBR BLU AAAAAgAQAAAAAAAAAAAAAAAAAAAAAAAAAAAAAAAAAACABAAAAA",
    // (char*) "SBR BL+ AAAAAgAIAAAAAAAAAAAAAAAAAAAAAAAAAAAAAAAAAAEABAAAAA",
    // (char*) "SBR BMp AAAAAgAEAAAAAAAAAAAAAAAAAAAAAAAAAAAAAAAAAAIABAAAAA",
    // (char*) "SBR BNT AAAAAgACAAAAAAAAAAAAAAAAAAAAAAAAAAAAAAAAAAQABAAAAA",
    // (char*) "SBR BN9 AAAAAgABAAAAAAAAAAAAAAAAAAAAAAAAAAAAAAAAAAgABAAAAA",
    // (char*) "SBR BOo AAAAAgAAgAAAAAAAAAAAAAAAAAAAAAAAAAAAAAAAABAABAAAAA",
    // (char*) "SBR BPS AAAAAgAAQAAAAAAAAAAAAAAAAAAAAAAAAAAAAAAAACAABAAAAA",
    // (char*) "SBR BP8 AAAAAgAAIAAAAAAAAAAAAAAAAAAAAAAAAAAAAAAAAEAABAAAAA",
    // (char*) "SBR BQn AAAAAgAAEAAAAAAAAAAAAAAAAAAAAAAAAAAAAAAAAIAABAAAAA",
    // (char*) "SBR BRR AAAAAgAACAAAAAAAAAAAAAAAAAAAAAAAAAAAAAAAAQAABAAAAA",
    // (char*) "SBR BR7 AAAAAgAABAAAAAAAAAAAAAAAAAAAAAAAAAAAAAAAAgAABAAAAA",
    // (char*) "SBR BSm AAAAAgAAAgAAAAAAAAAAAAAAAAAAAAAAAAAAAAAABAAABAAAAA",
    // (char*) "SBR BTQ AAAAAgAAAQAAAAAAAAAAAAAAAAAAAAAAAAAAAAAACAAABAAAAA",
    // (char*) "SBR BT6 AAAAAgAAAIAAAAAAAAAAAAAAAAAAAAAAAAAAAAAAEAAABAAAAA",
    // (char*) "SBR BUl AAAAAgAAAEAAAAAAAAAAAAAAAAAAAAAAAAAAAAAAIAAABAAAAA",
    // (char*) "SBR BVP AAAAAgAAACAAAAAAAAAAAAAAAAAAAAAAAAAAAAAAQAAABAAAAA",
    // (char*) "SBR BV5 AAAAAgAAABAAAAAAAAAAAAAAAAAAAAAAAAAAAAAAgAAABAAAAA",
    // (char*) "SBR BWk AAAAAgAAAAgAAAAAAAAAAAAAAAAAAAAAAAAAAAABAAAABAAAAA",
    // (char*) "SBR BXO AAAAAgAAAAQAAAAAAAAAAAAAAAAAAAAAAAAAAAACAAAABAAAAA",
    // (char*) "SBR BX4 AAAAAgAAAAIAAAAAAAAAAAAAAAAAAAAAAAAAAAAEAAAABAAAAA",
    // (char*) "SBR BYj AAAAAgAAAAEAAAAAAAAAAAAAAAAAAAAAAAAAAAAIAAAABAAAAA",
    // (char*) "SBR BZN AAAAAgAAAACAAAAAAAAAAAAAAAAAAAAAAAAAAAAQAAAABAAAAA",
    // (char*) "SBR BZ3 AAAAAgAAAABAAAAAAAAAAAAAAAAAAAAAAAAAAAAgAAAABAAAAA",
    // (char*) "SBR Bai AAAAAgAAAAAgAAAAAAAAAAAAAAAAAAAAAAAAAABAAAAABAAAAA",
    // (char*) "SBR BbM AAAAAgAAAAAQAAAAAAAAAAAAAAAAAAAAAAAAAACAAAAABAAAAA",
    // (char*) "SBR Bb2 AAAAAgAAAAAIAAAAAAAAAAAAAAAAAAAAAAAAAAEAAAAABAAAAA",
    // (char*) "SBR Bch AAAAAgAAAAAEAAAAAAAAAAAAAAAAAAAAAAAAAAIAAAAABAAAAA",
    // (char*) "SBR BdL AAAAAgAAAAACAAAAAAAAAAAAAAAAAAAAAAAAAAQAAAAABAAAAA",
    // (char*) "SBR Bd1 AAAAAgAAAAABAAAAAAAAAAAAAAAAAAAAAAAAAAgAAAAABAAAAA",
    // (char*) "SBR Beg AAAAAgAAAAAAgAAAAAAAAAAAAAAAAAAAAAAAABAAAAAABAAAAA",
    // (char*) "SBR BfK AAAAAgAAAAAAQAAAAAAAAAAAAAAAAAAAAAAAACAAAAAABAAAAA",
    // (char*) "SBR Bf0 AAAAAgAAAAAAIAAAAAAAAAAAAAAAAAAAAAAAAEAAAAAABAAAAA",
    // (char*) "SBR Bgf AAAAAgAAAAAAEAAAAAAAAAAAAAAAAAAAAAAAAIAAAAAABAAAAA",
    // (char*) "SBR BhJ AAAAAgAAAAAACAAAAAAAAAAAAAAAAAAAAAAAAQAAAAAABAAAAA",
    // (char*) "SBR Bhz AAAAAgAAAAAABAAAAAAAAAAAAAAAAAAAAAAAAgAAAAAABAAAAA",
    // (char*) "SBR Bie AAAAAgAAAAAAAgAAAAAAAAAAAAAAAAAAAAAABAAAAAAABAAAAA",
    // (char*) "SBR BjI AAAAAgAAAAAAAQAAAAAAAAAAAAAAAAAAAAAACAAAAAAABAAAAA",
    // (char*) "SBR Bjy AAAAAgAAAAAAAIAAAAAAAAAAAAAAAAAAAAAAEAAAAAAABAAAAA",
    // (char*) "SBR Bkd AAAAAgAAAAAAAEAAAAAAAAAAAAAAAAAAAAAAIAAAAAAABAAAAA",
    // (char*) "SBR BlH AAAAAgAAAAAAACAAAAAAAAAAAAAAAAAAAAAAQAAAAAAABAAAAA",
    // (char*) "SBR Blx AAAAAgAAAAAAABAAAAAAAAAAAAAAAAAAAAAAgAAAAAAABAAAAA",
    // (char*) "SBR Bmc AAAAAgAAAAAAAAgAAAAAAAAAAAAAAAAAAAABAAAAAAAABAAAAA",
    // (char*) "SBR BnG AAAAAgAAAAAAAAQAAAAAAAAAAAAAAAAAAAACAAAAAAAABAAAAA",
    // (char*) "SBR Bnw AAAAAgAAAAAAAAIAAAAAAAAAAAAAAAAAAAAEAAAAAAAABAAAAA",
    // (char*) "SBR Bob AAAAAgAAAAAAAAEAAAAAAAAAAAAAAAAAAAAIAAAAAAAABAAAAA",
    // (char*) "SBR BpF AAAAAgAAAAAAAACAAAAAAAAAAAAAAAAAAAAQAAAAAAAABAAAAA",
    // (char*) "SBR Bpv AAAAAgAAAAAAAABAAAAAAAAAAAAAAAAAAAAgAAAAAAAABAAAAA",
    // (char*) "SBR Bqa AAAAAgAAAAAAAAAgAAAAAAAAAAAAAAAAAABAAAAAAAAABAAAAA",
    // (char*) "SBR BrE AAAAAgAAAAAAAAAQAAAAAAAAAAAAAAAAAACAAAAAAAAABAAAAA",
    // (char*) "SBR Bru AAAAAgAAAAAAAAAIAAAAAAAAAAAAAAAAAAEAAAAAAAAABAAAAA",
    // (char*) "SBR BsZ AAAAAgAAAAAAAAAEAAAAAAAAAAAAAAAAAAIAAAAAAAAABAAAAA",
    // (char*) "SBR BtD AAAAAgAAAAAAAAACAAAAAAAAAAAAAAAAAAQAAAAAAAAABAAAAA",
    // (char*) "SBR Btt AAAAAgAAAAAAAAABAAAAAAAAAAAAAAAAAAgAAAAAAAAABAAAAA",
    // (char*) "SBR BuY AAAAAgAAAAAAAAAAgAAAAAAAAAAAAAAAABAAAAAAAAAABAAAAA",
    // (char*) "SBR BvC AAAAAgAAAAAAAAAAQAAAAAAAAAAAAAAAACAAAAAAAAAABAAAAA",
    // (char*) "SBR Bvs AAAAAgAAAAAAAAAAIAAAAAAAAAAAAAAAAEAAAAAAAAAABAAAAA",
    // (char*) "SBR BwX AAAAAgAAAAAAAAAAEAAAAAAAAAAAAAAAAIAAAAAAAAAABAAAAA",
    // (char*) "SBR BxB AAAAAgAAAAAAAAAACAAAAAAAAAAAAAAAAQAAAAAAAAAABAAAAA",
    // (char*) "SBR Bxr AAAAAgAAAAAAAAAABAAAAAAAAAAAAAAAAgAAAAAAAAAABAAAAA",
    // (char*) "SBR ByW AAAAAgAAAAAAAAAAAgAAAAAAAAAAAAAABAAAAAAAAAAABAAAAA",
    // (char*) "SBR BzA AAAAAgAAAAAAAAAAAQAAAAAAAAAAAAAACAAAAAAAAAAABAAAAA",
    // (char*) "SBR Bzq AAAAAgAAAAAAAAAAAIAAAAAAAAAAAAAAEAAAAAAAAAAABAAAAA",
    // (char*) "SBR B0V AAAAAgAAAAAAAAAAAEAAAAAAAAAAAAAAIAAAAAAAAAAABAAAAA",
    // (char*) "SBR B0/ AAAAAgAAAAAAAAAAACAAAAAAAAAAAAAAQAAAAAAAAAAABAAAAA",
    // (char*) "SBR B1p AAAAAgAAAAAAAAAAABAAAAAAAAAAAAAAgAAAAAAAAAAABAAAAA",
    // (char*) "SBR B2U AAAAAgAAAAAAAAAAAAgAAAAAAAAAAAABAAAAAAAAAAAABAAAAA",
    // (char*) "SBR B2+ AAAAAgAAAAAAAAAAAAQAAAAAAAAAAAACAAAAAAAAAAAABAAAAA",
    // (char*) "SBR B3o AAAAAgAAAAAAAAAAAAIAAAAAAAAAAAAEAAAAAAAAAAAABAAAAA",
    // (char*) "SBR B4T AAAAAgAAAAAAAAAAAAEAAAAAAAAAAAAIAAAAAAAAAAAABAAAAA",
    // (char*) "SBR B49 AAAAAgAAAAAAAAAAAACAAAAAAAAAAAAQAAAAAAAAAAAABAAAAA",
    // (char*) "SBR B5n AAAAAgAAAAAAAAAAAABAAAAAAAAAAAAgAAAAAAAAAAAABAAAAA",
    // (char*) "SBR B6S AAAAAgAAAAAAAAAAAAAgAAAAAAAAAABAAAAAAAAAAAAABAAAAA",
    // (char*) "SBR B68 AAAAAgAAAAAAAAAAAAAQAAAAAAAAAACAAAAAAAAAAAAABAAAAA",
    // (char*) "SBR B7m AAAAAgAAAAAAAAAAAAAIAAAAAAAAAAEAAAAAAAAAAAAABAAAAA",
    // (char*) "SBR B8R AAAAAgAAAAAAAAAAAAAEAAAAAAAAAAIAAAAAAAAAAAAABAAAAA",
    // (char*) "SBR B87 AAAAAgAAAAAAAAAAAAACAAAAAAAAAAQAAAAAAAAAAAAABAAAAA",
    // (char*) "SBR B9l AAAAAgAAAAAAAAAAAAABAAAAAAAAAAgAAAAAAAAAAAAABAAAAA",
    // (char*) "SBR B+Q AAAAAgAAAAAAAAAAAAAAgAAAAAAAABAAAAAAAAAAAAAABAAAAA",
    // (char*) "SBR B+6 AAAAAgAAAAAAAAAAAAAAQAAAAAAAACAAAAAAAAAAAAAABAAAAA",
    // (char*) "SBR B/k AAAAAgAAAAAAAAAAAAAAIAAAAAAAAEAAAAAAAAAAAAAABAAAAA",
    // (char*) "SBR CAP AAAAAgAAAAAAAAAAAAAAEAAAAAAAAIAAAAAAAAAAAAAABAAAAA",
    // (char*) "SBR CA5 AAAAAgAAAAAAAAAAAAAACAAAAAAAAQAAAAAAAAAAAAAABAAAAA",
    // (char*) "SBR CBj AAAAAgAAAAAAAAAAAAAABAAAAAAAAgAAAAAAAAAAAAAABAAAAA",
    // (char*) "SBR CCO AAAAAgAAAAAAAAAAAAAAAgAAAAAABAAAAAAAAAAAAAAABAAAAA",
    // (char*) "SBR CC4 AAAAAgAAAAAAAAAAAAAAAQAAAAAACAAAAAAAAAAAAAAABAAAAA",
    // (char*) "SBR CDi AAAAAgAAAAAAAAAAAAAAAIAAAAAAEAAAAAAAAAAAAAAABAAAAA",
    // (char*) "SBR CEN AAAAAgAAAAAAAAAAAAAAAEAAAAAAIAAAAAAAAAAAAAAABAAAAA",
    // (char*) "SBR CE3 AAAAAgAAAAAAAAAAAAAAACAAAAAAQAAAAAAAAAAAAAAABAAAAA",
    // (char*) "SBR CFh AAAAAgAAAAAAAAAAAAAAABAAAAAAgAAAAAAAAAAAAAAABAAAAA",
    // (char*) "SBR CGM AAAAAgAAAAAAAAAAAAAAAAgAAAABAAAAAAAAAAAAAAAABAAAAA",
    // (char*) "SBR CG2 AAAAAgAAAAAAAAAAAAAAAAQAAAACAAAAAAAAAAAAAAAABAAAAA",
    // (char*) "SBR CHg AAAAAgAAAAAAAAAAAAAAAAIAAAAEAAAAAAAAAAAAAAAABAAAAA",
    // (char*) "SBR CIL AAAAAgAAAAAAAAAAAAAAAAEAAAAIAAAAAAAAAAAAAAAABAAAAA",
    // (char*) "SBR CI1 AAAAAgAAAAAAAAAAAAAAAACAAAAQAAAAAAAAAAAAAAAABAAAAA",
    // (char*) "SBR CJf AAAAAgAAAAAAAAAAAAAAAABAAAAgAAAAAAAAAAAAAAAABAAAAA",
    // (char*) "SBR CKK AAAAAgAAAAAAAAAAAAAAAAAgAABAAAAAAAAAAAAAAAAABAAAAA",
    // (char*) "SBR CK0 AAAAAgAAAAAAAAAAAAAAAAAQAACAAAAAAAAAAAAAAAAABAAAAA",
    // (char*) "SBR CLe AAAAAgAAAAAAAAAAAAAAAAAIAAEAAAAAAAAAAAAAAAAABAAAAA",
    // (char*) "SBR CMJ AAAAAgAAAAAAAAAAAAAAAAAEAAIAAAAAAAAAAAAAAAAABAAAAA",
    // (char*) "SBR CMz AAAAAgAAAAAAAAAAAAAAAAACAAQAAAAAAAAAAAAAAAAABAAAAA",
    // (char*) "SBR CNd AAAAAgAAAAAAAAAAAAAAAAABAAgAAAAAAAAAAAAAAAAABAAAAA",
    // (char*) "SBR COI AAAAAgAAAAAAAAAAAAAAAAAAgBAAAAAAAAAAAAAAAAAABAAAAA",
    // (char*) "SBR COy AAAAAgAAAAAAAAAAAAAAAAAAQCAAAAAAAAAAAAAAAAAABAAAAA",
    // (char*) "SBR CPc AAAAAgAAAAAAAAAAAAAAAAAAIEAAAAAAAAAAAAAAAAAABAAAAA",
    // (char*) "SBR CQG AAAAAgAAAAAAAAAAAAAAAAAAEIAAAAAAAAAAAAAAAAAABAAAAA",
    // (char*) "SBR CQx AAAAAgAAAAAAAAAAAAAAAAAACQAAAAAAAAAAAAAAAAAABAAAAA",
    // (char*) "SBR CRb AAAAAgAAAAAAAAAAAAAAAAAABgAAAAAAAAAAAAAAAAAABAAAAA",
    // (char*) "SBR CSw AAAAAgAAAAAAAAAAAAAAAAAACQAAAAAAAAAAAAAAAAAABAAAAA",
    // (char*) "SBR CTa AAAAAgAAAAAAAAAAAAAAAAAAEIAAAAAAAAAAAAAAAAAABAAAAA",
    // (char*) "SBR CUF AAAAAgAAAAAAAAAAAAAAAAAAIEAAAAAAAAAAAAAAAAAABAAAAA",
    // (char*) "SBR CUv AAAAAgAAAAAAAAAAAAAAAAAAQCAAAAAAAAAAAAAAAAAABAAAAA",
    // (char*) "SBR CVZ AAAAAgAAAAAAAAAAAAAAAAAAgBAAAAAAAAAAAAAAAAAABAAAAA",
    // (char*) "SBR CWE AAAAAgAAAAAAAAAAAAAAAAABAAgAAAAAAAAAAAAAAAAABAAAAA",
    // (char*) "SBR CWu AAAAAgAAAAAAAAAAAAAAAAACAAQAAAAAAAAAAAAAAAAABAAAAA",
    // (char*) "SBR CXY AAAAAgAAAAAAAAAAAAAAAAAEAAIAAAAAAAAAAAAAAAAABAAAAA",
    // (char*) "SBR CYD AAAAAgAAAAAAAAAAAAAAAAAIAAEAAAAAAAAAAAAAAAAABAAAAA",
    // (char*) "SBR CYt AAAAAgAAAAAAAAAAAAAAAAAQAACAAAAAAAAAAAAAAAAABAAAAA",
    // (char*) "SBR CZX AAAAAgAAAAAAAAAAAAAAAAAgAABAAAAAAAAAAAAAAAAABAAAAA",
    // (char*) "SBR CaC AAAAAgAAAAAAAAAAAAAAAABAAAAgAAAAAAAAAAAAAAAABAAAAA",
    // (char*) "SBR Cas AAAAAgAAAAAAAAAAAAAAAACAAAAQAAAAAAAAAAAAAAAABAAAAA",
    // (char*) "SBR CbW AAAAAgAAAAAAAAAAAAAAAAEAAAAIAAAAAAAAAAAAAAAABAAAAA",
    // (char*) "SBR CcB AAAAAgAAAAAAAAAAAAAAAAIAAAAEAAAAAAAAAAAAAAAABAAAAA",
    // (char*) "SBR Ccr AAAAAgAAAAAAAAAAAAAAAAQAAAACAAAAAAAAAAAAAAAABAAAAA",
    // (char*) "SBR CdV AAAAAgAAAAAAAAAAAAAAAAgAAAABAAAAAAAAAAAAAAAABAAAAA",
    // (char*) "SBR CeA AAAAAgAAAAAAAAAAAAAAABAAAAAAgAAAAAAAAAAAAAAABAAAAA",
    // (char*) "SBR Ceq AAAAAgAAAAAAAAAAAAAAACAAAAAAQAAAAAAAAAAAAAAABAAAAA",
    // (char*) "SBR CfU AAAAAgAAAAAAAAAAAAAAAEAAAAAAIAAAAAAAAAAAAAAABAAAAA",
    // (char*) "SBR Cf/ AAAAAgAAAAAAAAAAAAAAAIAAAAAAEAAAAAAAAAAAAAAABAAAAA",
    // (char*) "SBR Cgp AAAAAgAAAAAAAAAAAAAAAQAAAAAACAAAAAAAAAAAAAAABAAAAA",
    // (char*) "SBR ChT AAAAAgAAAAAAAAAAAAAAAgAAAAAABAAAAAAAAAAAAAAABAAAAA",
    // (char*) "SBR Ch+ AAAAAgAAAAAAAAAAAAAABAAAAAAAAgAAAAAAAAAAAAAABAAAAA",
    // (char*) "SBR Cio AAAAAgAAAAAAAAAAAAAACAAAAAAAAQAAAAAAAAAAAAAABAAAAA",
    // (char*) "SBR CjS AAAAAgAAAAAAAAAAAAAAEAAAAAAAAIAAAAAAAAAAAAAABAAAAA",
    // (char*) "SBR Cj9 AAAAAgAAAAAAAAAAAAAAIAAAAAAAAEAAAAAAAAAAAAAABAAAAA",
    // (char*) "SBR Ckn AAAAAgAAAAAAAAAAAAAAQAAAAAAAACAAAAAAAAAAAAAABAAAAA",
    // (char*) "SBR ClR AAAAAgAAAAAAAAAAAAAAgAAAAAAAABAAAAAAAAAAAAAABAAAAA",
    // (char*) "SBR Cl8 AAAAAgAAAAAAAAAAAAABAAAAAAAAAAgAAAAAAAAAAAAABAAAAA",
    // (char*) "SBR Cmm AAAAAgAAAAAAAAAAAAACAAAAAAAAAAQAAAAAAAAAAAAABAAAAA",
    // (char*) "SBR CnQ AAAAAgAAAAAAAAAAAAAEAAAAAAAAAAIAAAAAAAAAAAAABAAAAA",
    // (char*) "SBR Cn7 AAAAAgAAAAAAAAAAAAAIAAAAAAAAAAEAAAAAAAAAAAAABAAAAA",
    // (char*) "SBR Col AAAAAgAAAAAAAAAAAAAQAAAAAAAAAACAAAAAAAAAAAAABAAAAA",
    // (char*) "SBR CpP AAAAAgAAAAAAAAAAAAAgAAAAAAAAAABAAAAAAAAAAAAABAAAAA",
    // (char*) "SBR Cp6 AAAAAgAAAAAAAAAAAABAAAAAAAAAAAAgAAAAAAAAAAAABAAAAA",
    // (char*) "SBR Cqk AAAAAgAAAAAAAAAAAACAAAAAAAAAAAAQAAAAAAAAAAAABAAAAA",
    // (char*) "SBR CrO AAAAAgAAAAAAAAAAAAEAAAAAAAAAAAAIAAAAAAAAAAAABAAAAA",
    // (char*) "SBR Cr5 AAAAAgAAAAAAAAAAAAIAAAAAAAAAAAAEAAAAAAAAAAAABAAAAA",
    // (char*) "SBR Csj AAAAAgAAAAAAAAAAAAQAAAAAAAAAAAACAAAAAAAAAAAABAAAAA",
    // (char*) "SBR CtN AAAAAgAAAAAAAAAAAAgAAAAAAAAAAAABAAAAAAAAAAAABAAAAA",
    // (char*) "SBR Ct4 AAAAAgAAAAAAAAAAABAAAAAAAAAAAAAAgAAAAAAAAAAABAAAAA",
    // (char*) "SBR Cui AAAAAgAAAAAAAAAAACAAAAAAAAAAAAAAQAAAAAAAAAAABAAAAA",
    // (char*) "SBR CvM AAAAAgAAAAAAAAAAAEAAAAAAAAAAAAAAIAAAAAAAAAAABAAAAA",
    // (char*) "SBR Cv3 AAAAAgAAAAAAAAAAAIAAAAAAAAAAAAAAEAAAAAAAAAAABAAAAA",
    // (char*) "SBR Cwh AAAAAgAAAAAAAAAAAQAAAAAAAAAAAAAACAAAAAAAAAAABAAAAA",
    // (char*) "SBR CxL AAAAAgAAAAAAAAAAAgAAAAAAAAAAAAAABAAAAAAAAAAABAAAAA",
    // (char*) "SBR Cx2 AAAAAgAAAAAAAAAABAAAAAAAAAAAAAAAAgAAAAAAAAAABAAAAA",
    // (char*) "SBR Cyg AAAAAgAAAAAAAAAACAAAAAAAAAAAAAAAAQAAAAAAAAAABAAAAA",
    // (char*) "SBR CzK AAAAAgAAAAAAAAAAEAAAAAAAAAAAAAAAAIAAAAAAAAAABAAAAA",
    // (char*) "SBR Cz1 AAAAAgAAAAAAAAAAIAAAAAAAAAAAAAAAAEAAAAAAAAAABAAAAA",
    // (char*) "SBR C0f AAAAAgAAAAAAAAAAQAAAAAAAAAAAAAAAACAAAAAAAAAABAAAAA",
    // (char*) "SBR C1J AAAAAgAAAAAAAAAAgAAAAAAAAAAAAAAAABAAAAAAAAAABAAAAA",
    // (char*) "SBR C10 AAAAAgAAAAAAAAABAAAAAAAAAAAAAAAAAAgAAAAAAAAABAAAAA",
    // (char*) "SBR C2e AAAAAgAAAAAAAAACAAAAAAAAAAAAAAAAAAQAAAAAAAAABAAAAA",
    // (char*) "SBR C3I AAAAAgAAAAAAAAAEAAAAAAAAAAAAAAAAAAIAAAAAAAAABAAAAA",
    // (char*) "SBR C3z AAAAAgAAAAAAAAAIAAAAAAAAAAAAAAAAAAEAAAAAAAAABAAAAA",
    // (char*) "SBR C4d AAAAAgAAAAAAAAAQAAAAAAAAAAAAAAAAAACAAAAAAAAABAAAAA",
    // (char*) "SBR C5H AAAAAgAAAAAAAAAgAAAAAAAAAAAAAAAAAABAAAAAAAAABAAAAA",
    // (char*) "SBR C5y AAAAAgAAAAAAAABAAAAAAAAAAAAAAAAAAAAgAAAAAAAABAAAAA",
    // (char*) "SBR C6c AAAAAgAAAAAAAACAAAAAAAAAAAAAAAAAAAAQAAAAAAAABAAAAA",
    // (char*) "SBR C7G AAAAAgAAAAAAAAEAAAAAAAAAAAAAAAAAAAAIAAAAAAAABAAAAA",
    // (char*) "SBR C7x AAAAAgAAAAAAAAIAAAAAAAAAAAAAAAAAAAAEAAAAAAAABAAAAA",
    // (char*) "SBR C8b AAAAAgAAAAAAAAQAAAAAAAAAAAAAAAAAAAACAAAAAAAABAAAAA",
    // (char*) "SBR C9F AAAAAgAAAAAAAAgAAAAAAAAAAAAAAAAAAAABAAAAAAAABAAAAA",
    // (char*) "SBR C9w AAAAAgAAAAAAABAAAAAAAAAAAAAAAAAAAAAAgAAAAAAABAAAAA",
    // (char*) "SBR C+a AAAAAgAAAAAAACAAAAAAAAAAAAAAAAAAAAAAQAAAAAAABAAAAA",
    // (char*) "SBR C/E AAAAAgAAAAAAAEAAAAAAAAAAAAAAAAAAAAAAIAAAAAAABAAAAA",
    // (char*) "SBR C/v AAAAAgAAAAAAAIAAAAAAAAAAAAAAAAAAAAAAEAAAAAAABAAAAA",
    // (char*) "SBR DAZ AAAAAgAAAAAAAQAAAAAAAAAAAAAAAAAAAAAACAAAAAAABAAAAA",
    // (char*) "SBR DBD AAAAAgAAAAAAAgAAAAAAAAAAAAAAAAAAAAAABAAAAAAABAAAAA",
    // (char*) "SBR DBu AAAAAgAAAAAABAAAAAAAAAAAAAAAAAAAAAAAAgAAAAAABAAAAA",
    // (char*) "SBR DCY AAAAAgAAAAAACAAAAAAAAAAAAAAAAAAAAAAAAQAAAAAABAAAAA",
    // (char*) "SBR DDC AAAAAgAAAAAAEAAAAAAAAAAAAAAAAAAAAAAAAIAAAAAABAAAAA",
    // (char*) "SBR DDt AAAAAgAAAAAAIAAAAAAAAAAAAAAAAAAAAAAAAEAAAAAABAAAAA",
    // (char*) "SBR DEX AAAAAgAAAAAAQAAAAAAAAAAAAAAAAAAAAAAAACAAAAAABAAAAA",
    // (char*) "SBR DFB AAAAAgAAAAAAgAAAAAAAAAAAAAAAAAAAAAAAABAAAAAABAAAAA",
    // (char*) "SBR DFs AAAAAgAAAAABAAAAAAAAAAAAAAAAAAAAAAAAAAgAAAAABAAAAA",
    // (char*) "SBR DGW AAAAAgAAAAACAAAAAAAAAAAAAAAAAAAAAAAAAAQAAAAABAAAAA",
    // (char*) "SBR DHA AAAAAgAAAAAEAAAAAAAAAAAAAAAAAAAAAAAAAAIAAAAABAAAAA",
    // (char*) "SBR DHr AAAAAgAAAAAIAAAAAAAAAAAAAAAAAAAAAAAAAAEAAAAABAAAAA",
    // (char*) "SBR DIV AAAAAgAAAAAQAAAAAAAAAAAAAAAAAAAAAAAAAACAAAAABAAAAA",
    // (char*) "SBR DI/ AAAAAgAAAAAgAAAAAAAAAAAAAAAAAAAAAAAAAABAAAAABAAAAA",
    // (char*) "SBR DJq AAAAAgAAAABAAAAAAAAAAAAAAAAAAAAAAAAAAAAgAAAABAAAAA",
    // (char*) "SBR DKU AAAAAgAAAACAAAAAAAAAAAAAAAAAAAAAAAAAAAAQAAAABAAAAA",
    // (char*) "SBR DK+ AAAAAgAAAAEAAAAAAAAAAAAAAAAAAAAAAAAAAAAIAAAABAAAAA",
    // (char*) "SBR DLp AAAAAgAAAAIAAAAAAAAAAAAAAAAAAAAAAAAAAAAEAAAABAAAAA",
    // (char*) "SBR DMT AAAAAgAAAAQAAAAAAAAAAAAAAAAAAAAAAAAAAAACAAAABAAAAA",
    // (char*) "SBR DM9 AAAAAgAAAAgAAAAAAAAAAAAAAAAAAAAAAAAAAAABAAAABAAAAA",
    // (char*) "SBR DNo AAAAAgAAABAAAAAAAAAAAAAAAAAAAAAAAAAAAAAAgAAABAAAAA",
    // (char*) "SBR DOS AAAAAgAAACAAAAAAAAAAAAAAAAAAAAAAAAAAAAAAQAAABAAAAA",
    // (char*) "SBR DO8 AAAAAgAAAEAAAAAAAAAAAAAAAAAAAAAAAAAAAAAAIAAABAAAAA",
    // (char*) "SBR DPn AAAAAgAAAIAAAAAAAAAAAAAAAAAAAAAAAAAAAAAAEAAABAAAAA",
    // (char*) "SBR DQR AAAAAgAAAQAAAAAAAAAAAAAAAAAAAAAAAAAAAAAACAAABAAAAA",
    // (char*) "SBR DQ7 AAAAAgAAAgAAAAAAAAAAAAAAAAAAAAAAAAAAAAAABAAABAAAAA",
    // (char*) "SBR DRm AAAAAgAABAAAAAAAAAAAAAAAAAAAAAAAAAAAAAAAAgAABAAAAA",
    // (char*) "SBR DSQ AAAAAgAACAAAAAAAAAAAAAAAAAAAAAAAAAAAAAAAAQAABAAAAA",
    // (char*) "SBR DS6 AAAAAgAAEAAAAAAAAAAAAAAAAAAAAAAAAAAAAAAAAIAABAAAAA",
    // (char*) "SBR DTl AAAAAgAAIAAAAAAAAAAAAAAAAAAAAAAAAAAAAAAAAEAABAAAAA",
    // (char*) "SBR DUP AAAAAgAAQAAAAAAAAAAAAAAAAAAAAAAAAAAAAAAAACAABAAAAA",
    // (char*) "SBR DU5 AAAAAgAAgAAAAAAAAAAAAAAAAAAAAAAAAAAAAAAAABAABAAAAA",
    // (char*) "SBR DVk AAAAAgABAAAAAAAAAAAAAAAAAAAAAAAAAAAAAAAAAAgABAAAAA",
    // (char*) "SBR DWO AAAAAgACAAAAAAAAAAAAAAAAAAAAAAAAAAAAAAAAAAQABAAAAA",
    // (char*) "SBR DW4 AAAAAgAEAAAAAAAAAAAAAAAAAAAAAAAAAAAAAAAAAAIABAAAAA",
    // (char*) "SBR DXj AAAAAgAIAAAAAAAAAAAAAAAAAAAAAAAAAAAAAAAAAAEABAAAAA",
    // (char*) "SBR DYN AAAAAgAQAAAAAAAAAAAAAAAAAAAAAAAAAAAAAAAAAACABAAAAA",
    // (char*) "SBR DY3 AAAAAgAgAAAAAAAAAAAAAAAAAAAAAAAAAAAAAAAAAABABAAAAA",
    // (char*) "SBR DZi AAAAAgBAAAAAAAAAAAAAAAAAAAAAAAAAAAAAAAAAAAAgBAAAAA",
    // (char*) "SBR DaM AAAAAgCAAAAAAAAAAAAAAAAAAAAAAAAAAAAAAAAAAAAQBAAAAA",
    // (char*) "SBR Da2 AAAAAgEAAAAAAAAAAAAAAAAAAAAAAAAAAAAAAAAAAAAIBAAAAA",
    // (char*) "SBR Dbh AAAAAgIAAAAAAAAAAAAAAAAAAAAAAAAAAAAAAAAAAAAEBAAAAA",
    // (char*) "SBR DcL AAAAAgQAAAAAAAAAAAAAAAAAAAAAAAAAAAAAAAAAAAACBAAAAA",
    // (char*) "SBR Dc1 AAAAAggAAAAAAAAAAAAAAAAAAAAAAAAAAAAAAAAAAAABBAAAAA",
    // (char*) "SBR Ddg AAAAAhAAAAAAAAAAAAAAAAAAAAAAAAAAAAAAAAAAAAAAhAAAAA",
    // (char*) "SBR DeK AAAAAiAAAAAAAAAAAAAAAAAAAAAAAAAAAAAAAAAAAAAARAAAAA",
    // (char*) "SBR De0 AAAAAkAAAAAAAAAAAAAAAAAAAAAAAAAAAAAAAAAAAAAAJAAAAA",
    // (char*) "SBR Dff AAAAAoAAAAAAAAAAAAAAAAAAAAAAAAAAAAAAAAAAAAAAFAAAAA",
    // (char*) "SBR DgJ AAAAAwAAAAAAAAAAAAAAAAAAAAAAAAAAAAAAAAAAAAAADAAAAA",
    // (char*) "SBR Dgz AAAAAgAAAAAAAAAAAAAAAAAAAAAAAAAAAAAAAAAAAAAABAAAAA",
    // (char*) "SBR Dhe AAAAA////////////////////////////////////////AAAAA",
    // (char*) "SBR D1U AAAAAAAAAAAAAAAAAAAAAAAAAAAAAAAAAAAAAAAAAAAAAAAAAA"
};

void printBufferInit()
{
  // Serial.println( "printBufferInit()" );
  
  char
    *p_position,
    *p_data,
    *buffer = (char*) malloc( 64 ),
    *rb
    ;

  for( int i = 0; i < TEST_BUFFER_SIZE; i++ )
  {
    copy( _pp_testBuffer[i], buffer );
    rb = buffer;

    p_position = 0;
    p_data = 0;

    // Serial.print( "\trb:  \"" );
    // Serial.print( rb );
    // Serial.print( "\"\t0x" );
    // Serial.print( (int) rb, HEX );
    // Serial.print( " \t" );

    while( *rb != '\0' )
    {
      // Serial.print( "\t*rb:  '" );
      // Serial.print( *rb );
      // Serial.print( "'\t0x" );
      // Serial.print( (int) rb, HEX );
      if( *rb == ' ' )
      {
        *rb = '\0';
        if( p_position == 0 )
        {
          p_position = rb + 1;
          // Serial.print( "\tp_position:  0x" );
          // Serial.print( (int) p_position, HEX );
        }
        else if( p_data == 0 )
        {
          p_data = rb + 1;
          // Serial.print( "\tp_data:  0x" );
          // Serial.print( (int) p_data, HEX );
        }
        else
        {
          // error code
        }
      }
      rb++;
      // Serial.print( "\tnext *rb:  '" );
      // Serial.print( *rb );
      // Serial.print( "'\t0x" );
      // Serial.println( (int) rb, HEX );
    }
    if( p_position != 0 && p_data != 0 )
    {
      // Serial.print( "Adding \"" );
      // Serial.print( p_data );
      // Serial.print( "\"\t to position \"" );
      // Serial.print( p_position );
      // Serial.println( "\"" );

      char* rd = p_data;
      while( *rd++ != '\0' );

      reverseBuffer( p_data, rd - p_data );

      // Serial.print( "\tAdding:  \"" );
      // Serial.print( p_data );
      // Serial.println( "\"" );

      addPrintElement( p_position, p_data );
    }
  }
  analyzeBuffer();
  free( buffer );
  auditPrintBuffer();
}

#endif // PRINT_TESTS


#ifdef TESTS

void cmpStrTests()
{
  cmpStrTest( "Hello World!", "Hello World!", true );
  cmpStrTest( "", "Hello World!", false );
  cmpStrTest( "Hello World!", "", false );
  cmpStrTest( "", "", true );
  cmpStrTest( "Hello World!", "Hello WOrld!", false );

}
void cmpStrTest( char* s0, char* s1, bool expectedResult )
{
  Serial.print( "cmpStrTest( \"" );
  Serial.print( s0 );
  Serial.print( "\", \"" );
  Serial.print( s1 );
  Serial.println( "\" )" );
  Serial.println( expectedResult == cmpStr( s0, s1) ? "pass" : "FAIL" );
}

void reverseStackTests()
{
  reverseStackTest( "Hello World!" );
  reverseStackTest( "" );
  reverseStackTest( "race car" );
}
void reverseStackTest( char* cBuffer )
{
  char* p_buffer = (char*) malloc( 100 );
  for( int i = 0; i < 100; i++ )
  {
    p_buffer[i] = '\0';
  }
  int blen = copy( cBuffer, p_buffer );
  Serial.println( "reverseStackTest(...)" );
  Serial.println( "\tBefore reverse:" );
  auditRawBuffer( p_buffer );

  Serial.print( "\n\tp_buffer:  \"" );
  Serial.print( p_buffer );
  Serial.println( "\"" );
  reverseBuffer( p_buffer, blen );

  Serial.println( "\tAfter reverse:" );
  auditRawBuffer( p_buffer );

  Serial.print( "\n\tp_buffer:  \"" );
  Serial.print( p_buffer );
  Serial.println( "\"" );

  free( p_buffer );
}

// void ConvertB6RawToBurst( char temp_input[50] )
// { //takes an array of 50 bytes where the 6 LSB are nozzle on or off, starting at 0 and ending at 299 and converts to a pointed uint16_t[22] burst array
//   uint16_t temp_nozzle = 0; //keeps track of the current nozzle
//   char temp_state; //used to write on or off to
//   char temp_add, temp_prim;
//   short* temp_burst = (short*) malloc( sizeof(short) * 22 );
//   for (uint8_t a = 0; a < 22; a++)
//   {
//     temp_burst[a] = 0;
//   }
//   for (int B = 0; B < 50; B++)
//   { //bytes within byte
//     for (int b = 0; b < 6; b++)
//     { //bits within byte
//       temp_add = nozzleTableAddress[temp_nozzle];
//       temp_prim = nozzleTablePrimitive[temp_nozzle];
      
//       temp_state = bitRead(temp_input[B], b); //get on or off from input

//       // bitWrite(temp_burst[temp_add], temp_prim, temp_state); //set nozzle in burst on or off

//       Serial.print( "Byte:  " );
//       Serial.print( B );
//       Serial.print( "\tbit:  " );
//       Serial.print( b );
//       Serial.print( "\tAddress:  " );
//       Serial.print( temp_add, DEC );
//       Serial.print( "\tPrimitive:  " );
//       Serial.print( temp_prim, DEC );
//       Serial.print( "\tValue:  " );
//       Serial.println( temp_state, DEC );

//       temp_nozzle ++; //add one to nozzle
//     }
//   }
//   // return temp_burst;
// }

void addrPrimUniquenessTest()
{
  Serial.println( "addrPrimUniquenessTest()" );
  struct NozzleControl* p_ncMaster;
  struct NozzleControl* p_ncSubIter;
  bool addressMatch, primitiveMatch, nozzleNumberMatch;

  int nonUniqueCount = 0;

  for( int i = 0; i < NOZZLE_COUNT; i++ )
  {
//struct NozzleControl* getNozzleController( int nozzleNumber )
    p_ncMaster = getNozzleController( i );
    for( int o = 0; o < NOZZLE_COUNT; o++ )
    {
      p_ncSubIter = getNozzleController( o );

      addressMatch = p_ncMaster->Address == p_ncSubIter->Address;
      primitiveMatch = p_ncMaster->Primitive == p_ncSubIter->Primitive;
      nozzleNumberMatch = p_ncMaster->NozzleNumber == p_ncSubIter->NozzleNumber;

      if( addressMatch && primitiveMatch && !nozzleNumberMatch )
      {
        nonUniqueCount++;
        Serial.print( "\t" );
        if( nonUniqueCount < 10 )
        {
          Serial.print( "  " );
        }
        else if( nonUniqueCount < 100 )
        {
          Serial.print( " " );
        }
        Serial.print( nonUniqueCount );
        Serial.print( "  Found non-unique address-primitive combo:  Nozzle #" );
        Serial.print( p_ncMaster->NozzleNumber );
        Serial.print( " & Nozzle # " );
        Serial.print( p_ncSubIter->NozzleNumber );
        Serial.print( " (A:  " );
        Serial.print( p_ncMaster->Address, DEC );
        Serial.print( "   P:  " );
        Serial.print( p_ncMaster->Primitive, DEC );
        Serial.println( ")" );
      }
      
    }
  }
}

void virtualVelocityTest()
{
  updateVirtualPosition();
}

void bufferPositionInit()
{
  addPrintElement( (char*) "O9",  (char*) "AAAAAAAAAAAAAAAAAAAAAAAAAAAAAAAAAAAAAAAAAAAAAAAAAA" );
  addPrintElement( (char*) "QS",  (char*) "BAAAAAAAAAAAAAAAAAAAAAAAAAAAAAAAAAAAAAAAAAAAAAAAAA" );
  addPrintElement( (char*) "Tm",  (char*) "AAAAAAAAAAAAAAAAAAAAAAAAAAAAAAAAAAAAAAAAAAAAAAAAAA" );
  addPrintElement( (char*) "BR7", (char*) "AAAAAAAAAfgAAAH/AAHAAAD4AAAAAAAA5wD8AAAAAAAAAAAAAA" );
  addPrintElement( (char*) "B+6", (char*) "AA/gAB4AAAAAAAAAGPwHAAD4AAAAAABwf8D8AA/+AB/8AAD+AA" );
  addPrintElement( (char*) "COI", (char*) "D8AAAAB+P4D8AgAA//8B8AD4D/gf8D/wfgD8AA//AD/+AAAAD8" );
  addPrintElement( (char*) "CYt", (char*) "B+AAAAAf/D8wDgAAB//B8AD4D8AAAAAA/8D8AP//8f//wAAAPw" );

  auditPrintBuffer();
}
void bufferPositionTests()
{
  bufferPositionTest( 0 );
  bufferPositionTest( 1000 );
  bufferPositionTest( 2000 );
  bufferPositionTest( 20000 );

  // for( int i = 950; i < 2000; i++ )
  // {
  //   bufferPositionTest(i);
  // }

}
void bufferPositionTest(int position)
{
  int correctIndex = gHPE_test(position);

  Serial.print( "bufferPositionTest( " );
  Serial.print( position );
  Serial.print( " )\tcorrectIndex:  " );
  Serial.println( correctIndex );
}

void oldAndNewTests()
{
  oldAndNewTest( "BAAAAAAAAAAAAAAAAAAAAAAAAAAAAAAAAAAAAAAAAAAAAAAAAA" );  // Byte 0, bit 0 should correspond to nozzle 0
  oldAndNewTest( "AAAAAAAAAAAAAAAAAAAAEAAAAAAAAAAAAAAAAAAAAAAAAAAAAA" );  // Byte 20, bit 3 should correspond to nozzle 122
}

void oldAndNewTest( char* testBurstSer )
{
  Serial.print( "oldAndNewTest( \"" );
  Serial.print( testBurstSer );
  Serial.println( "\"" );
  // this test will ensure the new software translates serial buffer print data into correct nozzle sequences, without all the overhead that dragonator's program had.
  // char *testBurstSer = "BAAAAAAAAAAAAAAAAAAAAAAAAAAAAAAAAAAAAAAAAAAAAAAAAA";
  char testBurstRaw [51];
  char* rtbr = testBurstRaw;

  Serial.print( "testBurstRaw:");
  for( int i = 0; i < 50; i++ )
  {
    testBurstRaw[i] = B64_to_B10( testBurstSer[i] );

    Serial.print( " " );
    Serial.print( *rtbr, DEC );
    rtbr++;
  }
  *rtbr = '\0';

  Serial.println( "" );

  dragonatorBufferToBurstMethod( testBurstRaw );

}

void dragonatorBufferToBurstMethod( char* serialBuffer )
{
  
  // some of the variable names were changed to make them more self-commenting.  Variable types are preserved for the most part
  uint16_t finalBurst [22];   // 22 addresses (buffer indices) and 14 primitives (buffer elements)
  uint16_t currentNozzle;
  int currentAddress, currentPrimitive, nozzleState;

  // Serial.println( "Converting buffer to burst:" );
  for( int B = 0; B < 50; B++ )
  {
    for( int b = 0; b < 6; b++ )
    {
      currentAddress = _p_nozzleTableAddresses[currentNozzle];// addressLookup( currentNozzle ); //
      currentPrimitive = _p_nozzleTablePrimitives[currentNozzle];// primitiveLookup( currentNozzle ); //

      nozzleState = bitRead( serialBuffer[B], b );  // apparently bitRead() is native to this framework... who knew?

      bitWrite( finalBurst[currentAddress], currentPrimitive, nozzleState );

      
      // Serial.print( "\t\tB:  " );
      // Serial.print( B );
      // Serial.print( "\tb:  " );
      // Serial.print( b );
      // Serial.print( "\tcurrentNozzle:  " );
      // Serial.print( currentNozzle );
      // Serial.print( "\tcurrentAddress:  " );
      // Serial.print( currentAddress );
      // Serial.print( "\tcurrentPrimitive:  " );
      // Serial.print( currentPrimitive );
      // Serial.print( "\tnozzleState:  " );
      // Serial.println( nozzleState );

      currentNozzle++;
    }
  }

  for( int addr = 0; addr < 22; addr++ )
  {
    Serial.print( "finalBurst[ " );
    if( addr < 10 )
    {
      Serial.print( " " );
    }
    Serial.print( addr );
    Serial.print( " ]" );
    for( int prim = 0; prim < 14; prim++ )
    {
      currentNozzle = getNozzleNumber( addr, prim );

      Serial.print( "   " );
      if( currentNozzle >= 0 && currentNozzle < 300 )
      {
        Serial.print( (finalBurst[addr] >> prim) & 0x1 );
        Serial.print( " (# " );
        if( currentNozzle < 10 )
        {
          Serial.print( "  " );
        }
        else if( currentNozzle < 100 )
        {
          Serial.print( " " );
        }
        Serial.print( currentNozzle );
       Serial.print( ")" );
      }
      else
      {
        Serial.print( "x        " );
      }
      if( prim == 13 )
      {
        Serial.println( "" );
      }
    }
  }
}

void nozzleTransitionTests()
{
  nozzleTransitionTestInit();
  // nozzleTransitionTest( 0, 3 );
  // nozzleTransitionTest( 5, 3 );

  // for( int i = 0; i < 300; i++ )
  // {
  //   nozzleTransitionTest( i );
  // }

  // analyzeBuffer();
}
void nozzleTransitionTestInit()
{
  // Serial.println( "nozzleTransitionTestInit()" );
//void addPrintElement( char* position, char* printData )
  addPrintElement( (char*) "O9",  (char*) "AAAAAAAAAAAAAAAAAAAAAAAAAAAAAAAAAAAAAAAAAAAAAAAAAA" );
  addPrintElement( (char*) "QS",  (char*) "BAAAAAAAAAAAAAAAAAAAAAAAAAAAAAAAAAAAAAAAAAAAAAAAAA" );
  addPrintElement( (char*) "Tm",  (char*) "AAAAAAAAAAAAAAAAAAAAAAAAAAAAAAAAAAAAAAAAAAAAAAAAAA" );
  addPrintElement( (char*) "BR7", (char*) "AAAAAAAAAfgAAAH/AAHAAAD4AAAAAAAA5wD8AAAAAAAAAAAAAA" );
  addPrintElement( (char*) "B+6", (char*) "AA/gAB4AAAAAAAAAGPwHAAD4AAAAAABwf8D8AA/+AB/8AAD+AA" );
  addPrintElement( (char*) "COI", (char*) "D8AAAAB+P4D8AgAA//8B8AD4D/gf8D/wfgD8AA//AD/+AAAAD8" );
  addPrintElement( (char*) "CYt", (char*) "B+AAAAAf/D8wDgAAB//B8AD4D8AAAAAA/8D8AP//8f//wAAAPw" );

  // auditPrintBuffer();
}
void nozzleTransitionTest( int nozzleNumber)
{
  Serial.print( "nozzleTransitionTest( " );
  Serial.print( nozzleNumber );
  Serial.println( " )" );

//int getNozzleTransitions( int nozzleNumber )
  int transitionCount = getNozzleTransitions( nozzleNumber );
  Serial.println( "(back to nozzleTransitionTest())" );
  Serial.print( "   transitionCount:  " );
  Serial.println( transitionCount );
  
}
void nozzleTransitionTest( int nozzleNumber, int expectedResult )
{
  Serial.print( "nozzleTransitionTest( " );
  Serial.print( nozzleNumber );
  Serial.print( ", " );
  Serial.print( expectedResult );
  Serial.println( " )" );

//int getNozzleTransitions( int nozzleNumber )
  int transitionCount = getNozzleTransitions( nozzleNumber );
  Serial.println( "(back to nozzleTransitionTest())" );
  Serial.print( "   transitionCount:  " );
  Serial.println( transitionCount );
  
}

void printBufferNozzleLookupTests()
{
  // printBufferNozzleLookupTest( 0, 0, 0 );
  // printBufferNozzleLookupTest( 1, 0, 1 );
  // printBufferNozzleLookupTest( 2, 0, 2 );
  // printBufferNozzleLookupTest( 3, 0, 3 );
  // printBufferNozzleLookupTest( 4, 0, 4 );
  // printBufferNozzleLookupTest( 5, 0, 5 );
  // printBufferNozzleLookupTest( 6, 1, 0 );
  // printBufferNozzleLookupTest( 7, 1, 1 );
  for( int i = 0; i < NOZZLE_COUNT; i++ )
  {
    printBufferNozzleLookupTest( i, i / 6, i % 6 );
  }
}
void printBufferNozzleLookupTest( int nozzleNumber, int expectedResultByte, int expectedResultBit )
{
  printBufferNozzleLookupTest( nozzleNumber, 50, expectedResultByte, expectedResultBit );
}
void printBufferNozzleLookupTest( int nozzleNumber, int blen, int expectedResultByte, int expectedResultBit )
{
  Serial.print( "printBufferNozzleLookupTest( " );
  Serial.print( nozzleNumber );
  Serial.print( ", " );
  Serial.print( blen );
  Serial.print( ", " );
  Serial.print( expectedResultByte );
  Serial.print( ", " );
  Serial.print( expectedResultBit );
  Serial.print( " )" );
  
  int
    byteIndex = 0,
    bitIndex = 0
    ;
    
  if( printBufferNozzleLookup( nozzleNumber, blen, &byteIndex, &bitIndex ) )
  {
    Serial.print( "   byteIndex:  " );
    Serial.print( byteIndex );
    Serial.print( "   bitIndex:  " );
    Serial.print( bitIndex );
    if( byteIndex == expectedResultByte && bitIndex == expectedResultBit )
    {
      Serial.println( "   pass" );
    }
    else
    {
      Serial.println( "   FAIL" );
    }
  }
  else
  {
    Serial.println( "   error" );
  }
}

void B64_to_B10Tests()
{
  B64_to_B10Test( 'A', 0 );
  B64_to_B10Test( 'B', 1 );
  B64_to_B10Test( 'c', 28 );
  B64_to_B10Test( (char*) "DWE", 13700 );
  // D = 3  -> *64^2 = 12,288
  // W = 22 -> *64^1 =  1,408
  // E = 4  -> *64^0 =      4
  //                   13,700
  // incidentally, that means roughly 14mm for printing, given the current swing limits

}
void B64_to_B10Test( char c, int expectedValue )
{
  Serial.print( "B64_To_B10Test( '" );
  Serial.print( c );
  Serial.print( "', " );
  Serial.print( expectedValue );
  Serial.print( " )" );
  int b10Value = B64_to_B10(c);
  Serial.print( "\tb10Value:  " );
  Serial.print( b10Value );

  if( b10Value == expectedValue )
  {
    Serial.println( "   pass" );
  }
  else
  {
    Serial.println( "   FAIL" );
  }
}
void B64_to_B10Test( char* buffer, int expectedValue )
{
  Serial.print( "B64_To_B10Test( \"" );
  Serial.print( buffer );
  Serial.print( "\", " );
  Serial.print( expectedValue );
  Serial.print( " )" );
  int b10Value = B64_to_B10(buffer);
  Serial.print( "\tb10Value:  " );
  Serial.print( b10Value );

  if( b10Value == expectedValue )
  {
    Serial.println( "   pass" );
  }
  else
  {
    Serial.println( "   FAIL" );
  }
}

void transitionCountTests()
{
  // transitionCountTest( (char*) "AAAAAAAAAAAAAAAAAAAAAAAAAAAAAAAAAAAAAAAAAAAAAAAAAA", 0 );
  // transitionCountTest( (char*) "AAAAAA/AAAAAAAAAAAAAAAAAAAAAAAAAAAAAAAAAAAAAAAAAAA", 2 );
  // transitionCountTest( (char*) "AAAAAA////////AAAAAAAAAAAAAAAAAAAAAAAAAAAAAAAAAAAA", 2 );
  // transitionCountTest( (char*) "AAAAAA/AAAAAA/AAAAAAAAAAAAAAAAAAAAAAAAAAAAAAAAAAAA", 4 );
  // transitionCountTest( (char*) "AAAAAA////////AAAAAAAAAAAAAAAAAAAAAAAAAAAAAAAAAAAA", 2 );
  // transitionCountTest( (char*) "AAAAAABAAAAAAAAAAAAAAAAAAAAAAAAAAAAAAAAAAAAAAAAAAA", 2 );
  // transitionCountTest( (char*) "AAAAAABABAAAAAAAAAAAAAAAAAAAAAAAAAAAAAAAAAAAAAAAAA", 4 );
  // transitionCountTest( (char*) "AAAAAAAAAB////////8AAAD4H/gH///A/8D8AAAAAAAAAAAAAA", -1 );
  // transitionCountTest( (char*) "B+AAAAB//h+4BgAAg///+AD4DwAAAAAA/4D8AH//4f//gAAAPw", -1 );
  // transitionCountTest( (char*) "A", 1, 0 );
  // transitionCountTest( (char*) "B", 1, 1 );
  // transitionCountTest( (char*) "a", 1, 4 );
  // transitionCountTest( (char*) "b", 1, 3 );
  transitionCountTest( (char*) "0", 1, 3 ); // remember:  bits 7 & 8 in each byte of the Print Data Buffer aren't used, so any transition between bit 6 and bit 7 is invalid
  transitionCountTest( (char*) "1", 1, 4 );
  // transitionCountTest( (char*) "", 0, 0 );
}
void transitionCountTest( char* buffer, int expectedCount )
{
  transitionCountTest( buffer, 50, expectedCount );
}
void transitionCountTest( char* buffer, int blen, int expectedCount )
{
  Serial.print( "transitionCountTest( \"" );
  Serial.print( buffer );
  Serial.print( "\", " );
  Serial.print( blen );
  Serial.print( ", " );
  Serial.print( expectedCount );
  Serial.print( " )" );
  int tcount = getElementTransitionCountTest( buffer, blen );
  Serial.print( "\ttcount:  " );
  Serial.print( tcount );
  if( tcount == expectedCount )
  {
    Serial.println( "\tpass" );
  }
  else if( expectedCount < 0 )
  {
    Serial.println( "\tno expected outcome given" );
  }
  else
  {
    Serial.println( "\tFAIL" );
  }
}



void beginsWithTests()
{
  beginsWithTest( "Hello World!", "Hell", true );
  beginsWithTest( "Hello World!", "ello", false );
  beginsWithTest( "Hello World!", "", false );
  beginsWithTest( "Hello World!", "xyz", false );
  beginsWithTest( "", "Hello", false );
  beginsWithTest( "H", "Hello", false );
  beginsWithTest( "H", "H", true );
  beginsWithTest( "", "", false );
}
void beginsWithTest(char* src, char* token, bool expectedResult )
{
  Serial.print( "beginsWithTest( \"" );
  Serial.print( src );
  Serial.print( "\", \"" );
  Serial.print( token );
  Serial.print( "\" )" );

  if( beginsWith( src, token ) == expectedResult )
  {
    Serial.println( "\tpass" );
  }
  else
  {
    Serial.println( "\tFAIL" );
  }
}

#endif // TESTS

#ifdef NOZZLE_FIRE_TEST
void nozzleFireTest()
{
  // Serial.println( "nozzleFireTest()" );
//   int hpAlloc = sizeof( struct HP_Print_Element );
//   struct HP_Print_Element* p_odd = (struct HP_Print_Element*) malloc( hpAlloc );
//   struct HP_Print_Element* p_even = (struct HP_Print_Element*) malloc( hpAlloc );
// // struct HP_Print_Element
// // {
// //   int
// //     Position,
// //     PrintDataSize,
// //     TransitionCount,
// //     Length,
// //     Detail,
// //     SweepsRequired
// //     ;
// //   char PrintData [ HP_COMMAND_LARGE_VALUE_ALLOC ];
// // };
//   for( int i = 0; i < HP_COMMAND_LARGE_VALUE_ALLOC; i++ )
//   {
//     p_odd->PrintData[i] = 0;
//     p_even->PrintData[i] = 0;
//   }
  char* pos0 = "uN";
  char* dat0 = "/A/A/A/A/A/A/A/A/A/A/A/A/A/A/A/A/A/A/A/A/A/A/A/A/A";
  char* pos1 = "CRb";
  char* dat1 = "//////////////////////////////////////////////////";
  char* pos2 = "D1U";
  char* dat2 = "AAAAAAAAAAAAAAAAAAAAAAAAAAAAAAAAAAAAAAAAAAAAAAAAAA";

//void addPrintElement( char* position, char* printData )
  addPrintElement( pos0, dat0 );
  addPrintElement( pos1, dat1 );
  addPrintElement( pos2, dat2 );

  analyzeBuffer();

  // auditPrintBuffer();

  int
    basePosition = 9307,
    offset = DISTANCE_BETWEEN_NOZZLES >> 1,
    oddPosition = basePosition - offset,
    evenPosition = basePosition + offset,
    oddIndex,
    evenIndex
    ;
  // Serial.print( "\t      offset:  " );
  // Serial.println( offset );
  // Serial.print( "\t oddPosition:  " );
  // Serial.println( oddPosition );
  // Serial.print( "\tevenPosition:  ");
  // Serial.println( evenPosition );

  struct HP_Print_Element* p_odd = getHighestPrintElementLowerThanOrEqualToPosition( oddPosition, &oddIndex, 0 );
  struct HP_Print_Element* p_even = getHighestPrintElementLowerThanOrEqualToPosition( evenPosition, &evenIndex, 0 );

  // Serial.print( "\tp_odd->Position:  " );
  // Serial.println( p_odd->Position );
  // Serial.print( "\tp_even->Position:  " );
  // Serial.println( p_even->Position );

  // setPrevIndices( 0, 1 );

  // Serial.println( "\n\n============================= Nozzle Audit, firing order =============================" );
  // for( int i = 0; i < NOZZLE_COUNT; i++ )
  // {
  //   auditNozzleController( _pp_nozzleFiringOrder[i] );
  // }
  // Serial.println( "============================= End Nozzle Audit =============================" );

  fireNozzles( p_odd, p_even, oddIndex, evenIndex, false, false );

  // looks like the sweep counts within the nozzles need work, and try to figure out why none of the nozzles are enabling
}
#endif // NOZZLE_FIRE_TEST