## zephyrproject/samples/basic/fwtic/build/Kconfig/Kconfig.modules
```kconfig
menu "canopennode (/home/jibon/zephyrproject/modules/lib/canopennode)"
osource "$(ZEPHYR_CANOPENNODE_KCONFIG)"
config ZEPHYR_CANOPENNODE_MODULE
	bool
	default y
endmenu
menu "chre (/home/jibon/zephyrproject/modules/lib/chre)"
osource "/home/jibon/zephyrproject/modules/lib/chre/platform/zephyr/Kconfig"
config ZEPHYR_CHRE_MODULE
	bool
	default y
endmenu
menu "hal_espressif (/home/jibon/zephyrproject/modules/hal/espressif)"
osource "/home/jibon/zephyrproject/modules/hal/espressif/zephyr/Kconfig"
config ZEPHYR_HAL_ESPRESSIF_MODULE
	bool
	default y
	select TAINT_BLOBS
endmenu
menu "hal_gigadevice (/home/jibon/zephyrproject/modules/hal/gigadevice)"
osource "$(ZEPHYR_HAL_GIGADEVICE_KCONFIG)"
config ZEPHYR_HAL_GIGADEVICE_MODULE
	bool
	default y
endmenu
menu "hal_infineon (/home/jibon/zephyrproject/modules/hal/infineon)"
osource "$(ZEPHYR_HAL_INFINEON_KCONFIG)"
config ZEPHYR_HAL_INFINEON_MODULE
	bool
	default y
endmenu
menu "hal_nordic (/home/jibon/zephyrproject/modules/hal/nordic)"
osource "$(ZEPHYR_HAL_NORDIC_KCONFIG)"
config ZEPHYR_HAL_NORDIC_MODULE
	bool
	default y
endmenu
menu "hal_nxp (/home/jibon/zephyrproject/modules/hal/nxp)"
osource "$(ZEPHYR_HAL_NXP_KCONFIG)"
config ZEPHYR_HAL_NXP_MODULE
	bool
	default y
endmenu
menu "hal_rpi_pico (/home/jibon/zephyrproject/modules/hal/rpi_pico)"
osource "$(ZEPHYR_HAL_RPI_PICO_KCONFIG)"
config ZEPHYR_HAL_RPI_PICO_MODULE
	bool
	default y
endmenu
menu "hal_telink (/home/jibon/zephyrproject/modules/hal/telink)"
osource "/home/jibon/zephyrproject/modules/hal/telink/Kconfig"
config ZEPHYR_HAL_TELINK_MODULE
	bool
	default y
endmenu
menu "liblc3 (/home/jibon/zephyrproject/modules/lib/liblc3)"
osource "$(ZEPHYR_LIBLC3_KCONFIG)"
config ZEPHYR_LIBLC3_MODULE
	bool
	default y
endmenu
menu "littlefs (/home/jibon/zephyrproject/modules/fs/littlefs)"
osource "$(ZEPHYR_LITTLEFS_KCONFIG)"
config ZEPHYR_LITTLEFS_MODULE
	bool
	default y
endmenu
menu "loramac-node (/home/jibon/zephyrproject/modules/lib/loramac-node)"
osource "$(ZEPHYR_LORAMAC_NODE_KCONFIG)"
config ZEPHYR_LORAMAC_NODE_MODULE
	bool
	default y
endmenu
menu "lvgl (/home/jibon/zephyrproject/modules/lib/gui/lvgl)"
osource "/home/jibon/zephyrproject/modules/lib/gui/lvgl/zephyr/Kconfig"
config ZEPHYR_LVGL_MODULE
	bool
	default y
endmenu
menu "lz4 (/home/jibon/zephyrproject/modules/lib/lz4)"
osource "$(ZEPHYR_LZ4_KCONFIG)"
config ZEPHYR_LZ4_MODULE
	bool
	default y
endmenu
menu "mbedtls (/home/jibon/zephyrproject/modules/crypto/mbedtls)"
osource "$(ZEPHYR_MBEDTLS_KCONFIG)"
config ZEPHYR_MBEDTLS_MODULE
	bool
	default y
endmenu
menu "nanopb (/home/jibon/zephyrproject/modules/lib/nanopb)"
osource "$(ZEPHYR_NANOPB_KCONFIG)"
config ZEPHYR_NANOPB_MODULE
	bool
	default y
endmenu
menu "openthread (/home/jibon/zephyrproject/modules/lib/openthread)"
osource "$(ZEPHYR_OPENTHREAD_KCONFIG)"
config ZEPHYR_OPENTHREAD_MODULE
	bool
	default y
endmenu
menu "picolibc (/home/jibon/zephyrproject/modules/lib/picolibc)"
osource "/home/jibon/zephyrproject/modules/lib/picolibc/zephyr/Kconfig"
config ZEPHYR_PICOLIBC_MODULE
	bool
	default y
endmenu
menu "sof (/home/jibon/zephyrproject/modules/audio/sof)"
osource "/home/jibon/zephyrproject/modules/audio/sof/zephyr/Kconfig"
config ZEPHYR_SOF_MODULE
	bool
	default y
endmenu
menu "tflite-micro (/home/jibon/zephyrproject/modules/lib/tflite-micro)"
osource "$(ZEPHYR_TFLITE_MICRO_KCONFIG)"
config ZEPHYR_TFLITE_MICRO_MODULE
	bool
	default y
endmenu
menu "TraceRecorder (/home/jibon/zephyrproject/modules/debug/TraceRecorder)"
osource "/home/jibon/zephyrproject/modules/debug/TraceRecorder/kernelports/Zephyr/Kconfig"
config ZEPHYR_TRACERECORDER_MODULE
	bool
	default y
endmenu
menu "trusted-firmware-m (/home/jibon/zephyrproject/modules/tee/tf-m/trusted-firmware-m)"
osource "$(ZEPHYR_TRUSTED_FIRMWARE_M_KCONFIG)"
config ZEPHYR_TRUSTED_FIRMWARE_M_MODULE
	bool
	default y
endmenu
menu "trusted-firmware-a (/home/jibon/zephyrproject/modules/tee/tf-a/trusted-firmware-a)"
osource "$(ZEPHYR_TRUSTED_FIRMWARE_A_KCONFIG)"
config ZEPHYR_TRUSTED_FIRMWARE_A_MODULE
	bool
	default y
endmenu
menu "uoscore-uedhoc (/home/jibon/zephyrproject/modules/lib/uoscore-uedhoc)"
osource "$(ZEPHYR_UOSCORE_UEDHOC_KCONFIG)"
config ZEPHYR_UOSCORE_UEDHOC_MODULE
	bool
	default y
endmenu
menu "zcbor (/home/jibon/zephyrproject/modules/lib/zcbor)"
osource "$(ZEPHYR_ZCBOR_KCONFIG)"
config ZEPHYR_ZCBOR_MODULE
	bool
	default y
endmenu
menu "zscilib (/home/jibon/zephyrproject/modules/lib/zscilib)"
osource "/home/jibon/zephyrproject/modules/lib/zscilib/Kconfig.zscilib"
config ZEPHYR_ZSCILIB_MODULE
	bool
	default y
endmenu
```

## zephyrproject/samples/basic/fwtic_v2/sample.yaml
```yaml
sample:
  name: fwtic Sample
tests:
  sample.basic.stm32_motor:
    tags: LED gpio
    filter: dt_enabled_alias_with_parent_compat("led0", "gpio-leds")
    depends_on: gpio
    harness: led
    integration_platforms:
      - frdm_k64f
```
